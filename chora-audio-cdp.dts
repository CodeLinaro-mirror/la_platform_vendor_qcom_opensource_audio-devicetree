//
/* Copyright (c) Qualcomm Technologies, Inc. and/or its subsidiaries.
 *  SPDX-License-Identifier: BSD-3-Clause-Clear
 */
/dts-v1/;
/plugin/;
#include "chora-audio-cdp.dtsi"
/ {
	model = "Qualcomm Technologies, Inc. chora CDP";
	compatible = "qcom,chora-cdp", "qcom,chora", "qcom,cdp";
	qcom,msm-id = <724 0x10000>;
	qcom,board-id = <0x10001 0>;
};
