/*
 * Copyright (c) 2025 Qualcomm Innovation Center, Inc. All rights reserved.
 * SPDX-License-Identifier: BSD-3-Clause
 */

/dts-v1/;
/plugin/;

#include <dt-bindings/interrupt-controller/arm-gic.h>
#include <dt-bindings/clock/qcom,gcc-vienna.h>
#include <dt-bindings/interconnect/qcom,vienna.h>
#include <dt-bindings/regulator/qcom,rpmh-regulator-levels.h>

#include "vienna-audio.dtsi"

/ {
	model = "Qualcomm Technologies, Inc. Vienna";
	compatible = "qcom,vienna";
	qcom,msm-id = <669 0x10000>;
        qcom,board-id = <0 0 >;
};

