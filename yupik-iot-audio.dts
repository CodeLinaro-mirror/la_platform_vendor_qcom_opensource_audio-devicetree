// SPDX-License-Identifier: BSD-3-Clause
/*
 * Copyright (c) 2025 Qualcomm Innovation Center, Inc. All rights reserved.
 */

/dts-v1/;
/plugin/;

#include "yupik-iot-audio.dtsi"

/ {
	model = "Qualcomm Technologies, Inc. YUPIK-IOT SoC";
	compatible = "qcom,yupik-iot";
	qcom,msm-id = <497 0x10000>, <498 0x10000>, <475 0x10000>, 
			<515 0x10000>, <575 0x10000>, <576 0x10000>;
	qcom,board-id = <0 0>;
};
