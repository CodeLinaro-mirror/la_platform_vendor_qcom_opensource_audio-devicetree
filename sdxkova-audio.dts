// SPDX-License-Identifier: BSD-3-Clause
/*
 * Copyright (c) Qualcomm Technologies, Inc. and/or its subsidiaries.
 */

/dts-v1/;
/plugin/;

#include <dt-bindings/clock/qcom,sdx75-gcc.h>
#include <dt-bindings/interrupt-controller/arm-gic.h>
#include <dt-bindings/interconnect/qcom,sdx75.h>
#include <dt-bindings/regulator/qcom,rpmh-regulator-levels.h>

#include "sdxkova-audio.dtsi"

/ {

	model = "Qualcomm Technologies, Inc. SDXKOVA";
	compatible = "qcom,sdxkova";
	qcom,msm-id = <556 0x10000>, <580 0x10000>, <609 0x10000>, <610 0x10000>, <677 0x10000>, <678 0x10000>, <679 0x10000>;
	qcom,board-id =<0x4040022 0x204>, <0x4010022 772>, <0x3020022 1027>, <0x4020022 772>, <0x20015 768>, <0x2020022 770>, <15 1024>, <0x10015 768>, <0x2010022 770>, <0x3010022 1027>, <0x4030022 772>, <0x2010022 0x402>, <0x10022 0x300>, <0x10022 0x400>, <0x2060022 0x202>, <0x20022 0x300>, <0x20022 0x400>, <0x30022 0x300>, <0x30022 0x400>, <0x2040022 0x202>, <0x1010022 0x401>, <0x1020022 0x401>, <0x1040022 0x401>, <0x1050022 0x401>, <0x3010022 0x303>, <0x3020022 0x303>, <0x2010022 0x302>, <0x2020022 0x302>, <0x2030022 0x302>, <0x2050022 0x302>, <0x10015 0x300>, <0x20015 0x300>, <0x30015 0x300>, <0x30015 0x400>, <0x40022 0x400>;
};

