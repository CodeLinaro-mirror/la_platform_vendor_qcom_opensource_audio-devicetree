#include "ravelin-audio-idp.dtsi"

&waipio_snd {
	qcom,msm-mbhc-usbc-audio-supported = <0>;
	qcom,msm-mbhc-hphl-swh = <0>;
	qcom,msm-mbhc-gnd-swh = <0>;
	qcom,ext-disp-audio-rx = <0>;
	qcom,wcn-bt = <0>;
	qcom,wcn-btfm = <0>;
};
