// SPDX-License-Identifier: BSD-3-Clause
/*
 * Copyright (c) 2023-2025 Qualcomm Innovation Center, Inc. All rights reserved.
 */

#include "canoe-audio-overlay.dtsi"
#include "canoe-audio-lpass-reg.dtsi"
&canoe_snd {
	qcom,wcn-bt-ext = <1>;
};
