/*
* Copyright (c) 2025 Qualcomm Innovation Center, Inc. All rights reserved.
* SPDX-License-Identifier: BSD-3-Clause
*/

/dts-v1/;
/plugin/;

#include <dt-bindings/clock/qcom,gcc-sdxbaagha.h>
#include <dt-bindings/interrupt-controller/arm-gic.h>
#include <dt-bindings/interconnect/qcom,sdxbaagha.h>
#include <dt-bindings/regulator/qcom,rpmh-regulator-levels.h>

#include "sa510m-audio.dtsi"

/ {

	model = "Qualcomm Technologies, Inc. SA510M IDP";
	compatible = "qcom,sa510m-idp", "qcom,sa510m-atp",
			"qcom,sa510m", "qcom,idp", "qcom,atp";
	qcom,msm-id = <697 0x10000>;
	qcom,board-id = <0x21 0x200>, <0x21 0x300>,
			<0x22 0x200>, <0x22 0x300>,
			<0x22 0x201>, <0x22 0x301>;
};
