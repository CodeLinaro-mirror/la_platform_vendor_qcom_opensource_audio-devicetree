//
/* Copyright (c) Qualcomm Technologies, Inc. and/or its subsidiaries.
 *  SPDX-License-Identifier: BSD-3-Clause-Clear
 */
/dts-v1/;
/plugin/;
#include "alor-audio-cdp.dtsi"
/ {
	model = "Qualcomm Technologies, Inc. Alor CDP";
	compatible = "qcom,alor-cdp", "qcom,alor", "qcom,cdp";
	qcom,msm-id = <685 0x10000>;
	qcom,board-id = <0x10001 0>;
};
