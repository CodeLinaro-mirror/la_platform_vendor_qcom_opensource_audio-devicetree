// SPDX-License-Identifier: BSD-3-Clause
/*
 * Copyright (c) 2025 Qualcomm Innovation Center, Inc. All rights reserved.
 */

/dts-v1/;
/plugin/;

#include "yupik-iot-audio-overlay.dtsi"

/ {
        model = "Qualcomm Technologies, Inc. YupikP IoT HSP";
        compatible = "qcom,yupikp-iot-idp", "qcom,yupikp-iot", "qcom,idp";
        qcom,msm-id = <498 0x10000>, <575 0x10000>, <576 0x10000>,
			<0x40001F1 0x10000>, <0x400023F 0x10000>, <0x4000240 0x10000>,
                        <0x200001F1 0x10000>, <0x2000023F 0x10000>, <0x20000240 0x10000>,
                        <0x80001F1 0x10000>, <0x800023F 0x10000>, <0x8000240 0x10000>,
                        <0xC0001F1 0x10000>, <0xC00023F 0x10000>, <0xC000240 0x10000>;
        qcom,board-id = <34 1>;
};
