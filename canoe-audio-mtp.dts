// SPDX-License-Identifier: BSD-3-Clause
/*
 * Copyright (c) 2023-2024 Qualcomm Innovation Center, Inc. All rights reserved.
 */

/dts-v1/;
/plugin/;

#include "canoe-audio-mtp.dtsi"
 / {
	model = "Qualcomm Technologies, Inc. Canoe MTP";
	compatible = "qcom,canoe-mtp", "qcom,canoe", "qcom,mtp";
	qcom,msm-id = <0x10294 0x10000>, <0x10294 0x20000>, <0x10295 0x10000>, <0x10295 0x20000>,
		      <0x1010294 0x10000>, <0x1010294 0x20000>, <0x1010295 0x10000>,
		      <0x1010295 0x20000>;
	qcom,board-id = <8 0>;
};
