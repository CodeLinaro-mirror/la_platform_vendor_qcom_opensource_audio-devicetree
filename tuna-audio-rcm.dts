//
/* Copyright (c) Qualcomm Technologies, Inc. and/or its subsidiaries.
 *  SPDX-License-Identifier: BSD-3-Clause
 */

/dts-v1/;
/plugin/;

#include "tuna-audio-cdp.dtsi"
/ {
	model = "Qualcomm Technologies, Inc. Tuna RCM";
	compatible = "qcom,tuna-rcm", "qcom,tuna", "qcom,tunap-rcm", "qcom,tunap",
			"qcom,rcm";
	qcom,msm-id = <681 0x10000>, <655 0x10000>, <694 0x10000>;
	qcom,board-id = <21 0>;
};
