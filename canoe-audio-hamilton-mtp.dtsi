//
/* Copyright (c) Qualcomm Technologies, Inc. and/or its subsidiaries.
 *  SPDX-License-Identifier: BSD-3-Clause
 */

#include "canoe-audio-mtp-wsa885x.dtsi"

&lpass_bt_swr {
	status = "disabled";
};

&canoe_snd {
	qcom,model = "canoe-mtp-snd-card";
	qcom,wcn-bt = <1>;
	qcom,msm_audio_ssr_devs = <&audio_gpr>, <&lpi_tlmm>,
                               <&lpass_cdc>;
	qcom,wcn-bt-ext = <0>;
};

