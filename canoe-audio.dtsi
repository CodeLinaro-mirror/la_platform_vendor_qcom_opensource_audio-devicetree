//
/* Copyright (c) Qualcomm Technologies, Inc. and/or its subsidiaries.
 * SPDX-License-Identifier: BSD-3-Clause-Clear
 */

#include <bindings/qcom,audio-ext-clk.h>
#include <bindings/qcom,gpr.h>
#include "msm-audio.dtsi"

&spf_core_platform {
	canoe_snd: sound {
		compatible = "qcom,canoe-asoc-snd";
		qcom,mi2s-audio-intf = <1>;
		qcom,tdm-audio-intf = <0>;
		qcom,auxpcm-audio-intf = <1>;
		qcom,wcn-bt = <1>;
		qcom,ext-disp-audio-rx = <1>;

		clock-names = "lpass_audio_hw_vote";
		clocks = <&lpass_audio_hw_vote 0>;
	};
};
