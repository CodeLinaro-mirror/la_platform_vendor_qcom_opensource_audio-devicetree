//
/* Copyright (c) Qualcomm Technologies, Inc. and/or its subsidiaries.
 *  SPDX-License-Identifier: BSD-3-Clause
 */

#include "tuna-audio-mtp.dtsi"


&lpass_bt_swr {
	status = "disabled";
};

&tuna_snd {
	qcom,model = "tuna-mtp-snd-card";
	qcom,wcn-bt = <1>;
	qcom,msm_audio_ssr_devs = <&audio_gpr>, <&lpi_tlmm>,
				<&lpass_cdc>;
};
