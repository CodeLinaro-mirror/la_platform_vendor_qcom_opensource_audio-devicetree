/*
 * SPDX-License-Identifier: BSD-3-Clause
 * Copyright (c) Qualcomm Technologies, Inc. and/or its subsidiaries.
*/

/dts-v1/;
/plugin/;

#include "arth-audio-qrd.dtsi"
 / {
	model = "Qualcomm Technologies, Inc. Arth QRD";
	compatible = "qcom,art-qrd", "qcom,art", "qcom,artp-qrd", "qcom,artp",
		"qcom,qrd", "qcom,arth-qrd", "qcom,arth", "qcom,pebble", "qcom,pebble-qrd";
	qcom,msm-id = <760 0x10000>;
	qcom,board-id = <0x2000B 0x0>;
};
