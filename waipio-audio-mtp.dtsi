// SPDX-License-Identifier: BSD-3-Clause
/*
 * Copyright (c) Qualcomm Technologies, Inc. and/or its subsidiaries.
 */

#include "waipio-audio-overlay.dtsi"

&cdc_tert_mi2s_gpios {
	status = "ok";
};

&waipio_snd {
	qcom,tert-mi2s-gpios = <&cdc_tert_mi2s_gpios>;
};