/*
 * Copyright (c) Qualcomm Technologies, Inc. and/or its subsidiaries.
 * SPDX-License-Identifier: BSD-3-Clause-Clear
*/

/dts-v1/;
/plugin/;

#include "art-audio-cdp.dtsi"
 / {
	model = "Qualcomm Technologies, Inc. Art CDP";
	compatible = "qcom,art-cdp", "qcom,art", "qcom,artp-cdp", "qcom,artp",
			   "qcom,cdp";
	qcom,msm-id = <707 0x10000>, <707 0x20000>, <708 0x10000>, <708 0x20000>
			, <760 0x10000>;
	qcom,board-id = <1 0>, <0x50001 0x0>, <0x10000001 0>;
};
