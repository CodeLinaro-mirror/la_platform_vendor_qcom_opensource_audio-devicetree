// SPDX-License-Identifier: BSD-3-Clause
/*
 * Copyright (c) Qualcomm Technologies, Inc. and/or its subsidiaries.
 */

/dts-v1/;
/plugin/;

#include "pebble-audio-cdp.dtsi"

&lpass_bt_swr {
	status = "disabled";
};

&art_snd {
	qcom,model = "pebble-cdp-snd-card";
	qcom,wcn-bt = <1>;
	qcom,msm_audio_ssr_devs = <&audio_gpr>, <&lpi_tlmm>,
			<&lpass_cdc>;
	qcom,wcn-bt-ext = <0>;
};
