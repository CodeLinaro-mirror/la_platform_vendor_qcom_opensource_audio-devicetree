/*
 *Copyright (c) Qualcomm Technologies, Inc. and/or its subsidiaries.
 */
//SPDX-License-Identifier: BSD-3-Clause

/dts-v1/;
/plugin/;

#include <dt-bindings/interrupt-controller/arm-gic.h>
#include <dt-bindings/regulator/qcom,rpmh-regulator-levels.h>

#include "lemans-vm-audio.dtsi"

/ {
	model = "Qualcomm Technologies, Inc. Lemans LA Flex Virtual Machine";
	compatible = "qcom,lemans", "qcom,quinvm";
	qcom,msm-id = <534 0x20000>;
	qcom,board-id = <0x0 0x1000001>, <0 0x2000001>, <0x0 0x3000001>;
};
