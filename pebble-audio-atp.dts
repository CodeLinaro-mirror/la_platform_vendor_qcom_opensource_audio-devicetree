// SPDX-License-Identifier: BSD-3-Clause
/*
 * Copyright (c) Qualcomm Technologies, Inc. and/or its subsidiaries.
 */

/dts-v1/;
/plugin/;

#include "pebble-audio-atp.dtsi"

/ {
	model = "Qualcomm Technologies, Inc. Pebble ATP Fig + Pandeiro";
	compatible = "qcom,pebble-atp", "qcom,pebblep-atp", "qcom,atp", "qcom,pebble",
	"qcom,pebblep";
	qcom,msm-id = <735 0x10000>, <735 0x10001>, <741 0x10000>, <741 0x10001>;
	qcom,board-id = <0x10021 0x0>, <0x20021 0x0>;
};
