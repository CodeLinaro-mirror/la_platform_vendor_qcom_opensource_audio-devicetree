//
/* Copyright (c) Qualcomm Technologies, Inc. and/or its subsidiaries.
 *  SPDX-License-Identifier: BSD-3-Clause-Clear
 */

#include "lpass-audio-cdc-1.0.dtsi"
#include "art-lpi.dtsi"
#include "lpass-audio-bt-swr.dtsi"
#include "lpass-cdc-gpio.dtsi"
#include "art-audio-lpass-reg.dtsi"
#include "wcd.dtsi"

&art_snd {
	qcom,model = "art-cdp-snd-card";
	compatible = "qcom,art-asoc-snd-stub";
	asoc-codec = <&stub_codec>;
	asoc-codec-names = "msm-stub-codec.1";
};

&lpi_tlmm {
	status = "disabled";
};

&lpass_cdc {
	status = "disabled";
};

&lpass_bt_swr {
	status = "disabled";
};
