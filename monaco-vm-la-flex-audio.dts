/*
 *Copyright (c) Qualcomm Technologies, Inc. and/or its subsidiaries.
 */
//SPDX-License-Identifier: BSD-3-Clause

/dts-v1/;
/plugin/;

#include <dt-bindings/interrupt-controller/arm-gic.h>
#include <dt-bindings/regulator/qcom,rpmh-regulator-levels.h>

#include "monaco-vm-audio.dtsi"

/ {
	model = "Qualcomm Technologies, Inc. Monaco Flex LA Virtual Machine";
	compatible = "qcom,monaco", "qcom,quinvm";
	qcom,msm-id = <695 0x10000>;
	qcom,board-id = <0x0 0x1000001>, <0 0x2000001>, <0x0 0x3000001>;
};
