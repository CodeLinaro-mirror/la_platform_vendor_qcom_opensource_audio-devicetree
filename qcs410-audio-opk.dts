// SPDX-License-Identifier: BSD-3-Clause
/*
 * Copyright (c) Qualcomm Technologies, Inc. and/or its subsidiaries.
 */

/dts-v1/;
/plugin/;

#include "qcs610-audio-opk.dtsi"

/ {
	model = "Qualcomm Technologies, Inc. QCS410 Openkit Overlay";
	compatible = "qcom,qcs410-opk", "qcom,qcs410", "qcom,opk";
	qcom,msm-id = <406 0x0>;
	qcom,board-id = <32 3>;
};

