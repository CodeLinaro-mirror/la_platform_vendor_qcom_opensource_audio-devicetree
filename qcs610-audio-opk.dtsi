// SPDX-License-Identifier: BSD-3-Clause
/*
 * Copyright (c) Qualcomm Technologies, Inc. and/or its subsidiaries.
 */

#include "sm6150-audio.dtsi"
#include "sm6150-ext-codec-audio-overlay.dtsi"
#include "sm6150-external-codec.dtsi"
