//
/* Copyright (c) Qualcomm Technologies, Inc. and/or its subsidiaries.
 *  SPDX-License-Identifier: BSD-3-Clause
 */

/dts-v1/;
/plugin/;

#include "tuna-audio-mtp-qmp1000.dtsi"

/ {
	model = "Qualcomm Technologies, Inc. Tuna MTP QMP1000";
	compatible = "qcom,tuna-mtp", "qcom,tuna", "qcom,tunap-mtp", "qcom,tunap",
			"qcom,mtp";
	qcom,msm-id = <681 0x10000>, <655 0x10000>, <694 0x10000>;
	qcom,board-id = <8 1>;
};

