// SPDX-License-Identifier: BSD-3-Clause
/*
 * Copyright (c) Qualcomm Technologies, Inc. and/or its subsidiaries.
 */

/dts-v1/;
/plugin/;

#include "art-audio-rumi.dtsi"

/ {
	model = "Qualcomm Technologies, Inc. Pebble RUMI";
	compatible = "qcom,pebble-rumi", "qcom,pebble", "qcom,rumi";
	qcom,msm-id = <735 0x10000>;
	qcom,board-id = <15 0>;
};
