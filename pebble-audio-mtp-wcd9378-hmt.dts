// SPDX-License-Identifier: BSD-3-Clause
/*
 * Copyright (c) Qualcomm Technologies, Inc. and/or its subsidiaries.
 */

/dts-v1/;
/plugin/;

#include "pebble-audio-mtp-wcd9378-hmt.dtsi"

/ {
	model = "Qualcomm Technologies, Inc. Pebble MTP + wcn7750 + Estoril";
	compatible = "qcom,pebble-mtp", "qcom,pebblep-mtp", "qcom,mtp", "qcom,pebble", "qcom,pebblep";
	qcom,msm-id = <735 0x10000>, <735 0x10001>, <741 0x10000>, <741 0x10001>;
	qcom,board-id = <0x10208 0x0>;
};
