/*
 * Copyright (c) Qualcomm Technologies, Inc. and/or its subsidiaries.
 * SPDX-License-Identifier: BSD-3-Clause
*/

/dts-v1/;
/plugin/;

#include "arth-audio-cdp.dtsi"
 / {
	model = "Qualcomm Technologies, Inc. Pebble CDP";
	compatible = "qcom,art-cdp", "qcom,art", "qcom,artp-cdp", "qcom,artp",
			   "qcom,cdp";
	qcom,msm-id =  <760 0x10000>;
	qcom,board-id = <0x50001 0x0>;
};
