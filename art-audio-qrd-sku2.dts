/*
 * Copyright (c) Qualcomm Technologies, Inc. and/or its subsidiaries.
 * SPDX-License-Identifier: BSD-3-Clause-Clear
*/

/dts-v1/;
/plugin/;

#include "art-audio-qrd-sku2.dtsi"
 / {
	model = "Qualcomm Technologies, Inc. Art QRD";
	compatible = "qcom,art-qrd", "qcom,art", "qcom,artp-qrd", "qcom,artp",
			   "qcom,qrd";
	qcom,msm-id = <707 0x10000>, <707 0x20000>, <708 0x10000>, <708 0x20000>
			, <755 0x10000>;
	qcom,board-id = <0x2000B 0>, <0x1002000b 0>, <0x2100b 0>, <0x2200b 0>;
};
