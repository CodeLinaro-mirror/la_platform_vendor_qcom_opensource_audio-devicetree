// SPDX-License-Identifier: BSD-3-Clause
/*
 * Copyright (c) Qualcomm Technologies, Inc. and/or its subsidiaries.
 */

#include "sun-audio-qrd.dtsi"

&sun_snd {
	qcom,model = "sun-qrd-snd-card";

	qcom,msm-mbhc-usbc-audio-supported = <0>;
	qcom,msm-mbhc-hphl-swh = <1>;
	qcom,msm-mbhc-gnd-swh = <1>;
	qcom,wcn-bt-ext = <0>;
	qcom,tdm-audio-intf = <1>;
};
