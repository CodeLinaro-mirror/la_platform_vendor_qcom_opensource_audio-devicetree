// SPDX-License-Identifier: BSD-3-Clause
/*
 * Copyright (c) Qualcomm Technologies, Inc. and/or its subsidiaries.
 */

/dts-v1/;
/plugin/;

#include "yupik-iot-audio-controller.dtsi"

/ {
	model = "Qualcomm Technologies, Inc. YupikP IoT Touch Controller";
	compatible = "qcom,yupik-iot-idp", "qcom,yupik-iot", "qcom,idp";
	qcom,msm-id = <498 0x10000>, <575 0x10000>;
	qcom,board-id = <0x100020 0xC>;
};

