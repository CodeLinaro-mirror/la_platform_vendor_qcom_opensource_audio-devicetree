/*
 * SPDX-License-Identifier: BSD-3-Clause
 * Copyright (c) Qualcomm Technologies, Inc. and/or its subsidiaries.
*/

/dts-v1/;
/plugin/;

#include "arth-audio-mtp.dtsi"
 / {
	model = "Qualcomm Technologies, Inc. Art MTP";
	compatible = "qcom,art-mtp", "qcom,art", "qcom,artp-mtp", "qcom,artp",
			   "qcom,mtp";
	qcom,msm-id = <760 0x10000>;
	qcom,board-id = <0x40008 0>;
};
