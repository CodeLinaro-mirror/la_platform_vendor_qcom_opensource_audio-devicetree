// SPDX-License-Identifier: BSD-3-Clause
/*
 * Copyright (c) Qualcomm Technologies, Inc. and/or its subsidiaries.
 */
/dts-v1/;
/plugin/;

#include "diwali-audio-idp-usbc.dtsi"

/ {
	model = "Qualcomm Technologies, Inc. Diwali IDP USBC audio";
	compatible = "qcom,diwali-idp", "qcom,diwali", "qcom,idp";
	qcom,msm-id = <506 0x10000>, <547 0x10000>, <564 0x10000>;
	qcom,board-id = <34 1>;
};
