//
/* Copyright (c) Qualcomm Technologies, Inc. and/or its subsidiaries.
 *  SPDX-License-Identifier: BSD-3-Clause-Clear
 */

#include <bindings/qcom,audio-ext-clk.h>
#include <bindings/qcom,lpass-cdc-clk-rsc.h>
#include <bindings/audio-codec-port-types.h>
#include <dt-bindings/interrupt-controller/arm-gic.h>
#include "canoe-lpi.dtsi"

&lpass_cdc {


	va_macro: va-macro@7660000 {

			wcd939x_tx_slave: wcd939x-tx-slave {
				compatible = "qcom,wcd939x-slave";
				reg = <0x0E 0x01170223>;
			};

	};



	rx_macro: rx-macro@6AC0000 {

			wcd939x_rx_slave: wcd939x-rx-slave {
				compatible = "qcom,wcd939x-slave";
				reg = <0x0E 0x01170224>;
			};

	};

	wsa_macro: wsa-macro@6B00000 {

		wsa_data_fs_ctl_reg = <0x6B6F000>;

		qcom,wsa-bat-cfgs= <1>, <1>;
		qcom,wsa-rloads= <2>, <2>;
		qcom,wsa-system-gains= <0 9>, <0 9>;


			wsa884x_0220: wsa884x@02170220 {
				compatible = "qcom,wsa884x";
				reg = <0x4 0x2170220>;
				qcom,spkr-sd-n-node = <&wsa_spkr_en02>;
				qcom,lpass-cdc-handle = <&lpass_cdc>;
				qcom,wsa-macro-handle = <&wsa_macro>;
				qcom,swr-wsa-port-params =
					<OFFSET1_VAL1 LANE0>, <OFFSET1_VAL3 LANE0>, <OFFSET1_VAL5 LANE0>, <OFFSET1_VAL0 LANE0>, <OFFSET1_VAL6 LANE0>, <OFFSET1_VAL0 LANE0>,
					<OFFSET1_VAL1 LANE0>, <OFFSET1_VAL3 LANE0>, <OFFSET1_VAL5 LANE0>, <OFFSET1_VAL0 LANE0>, <OFFSET1_VAL6 LANE0>, <OFFSET1_VAL0 LANE0>,
					<OFFSET1_VAL1 LANE0>, <OFFSET1_VAL3 LANE0>, <OFFSET1_VAL5 LANE0>, <OFFSET1_VAL0 LANE0>, <OFFSET1_VAL6 LANE0>, <OFFSET1_VAL0 LANE0>,
					<OFFSET1_VAL1 LANE0>, <OFFSET1_VAL3 LANE0>, <OFFSET1_VAL5 LANE0>, <OFFSET1_VAL0 LANE0>, <OFFSET1_VAL6 LANE0>, <OFFSET1_VAL0 LANE0>;
				cdc-vdd-1p8-supply = <&L15B>;
				qcom,cdc-vdd-1p8-voltage = <1800000 1800000>;
				qcom,cdc-vdd-1p8-current = <20000>;
				qcom,cdc-vdd-1p8-lpm-supported = <1>;
				qcom,cdc-static-supplies = "cdc-vdd-1p8";
				sound-name-prefix = "SpkrLeft";
			};

			wsa884x_0221: wsa884x@02170221 {
				compatible = "qcom,wsa884x";
				reg = <0x4 0x2170221>;
				qcom,spkr-sd-n-node = <&wsa_spkr_en13>;
				qcom,lpass-cdc-handle = <&lpass_cdc>;
				qcom,wsa-macro-handle = <&wsa_macro>;
				qcom,swr-wsa-port-params =
					<OFFSET1_VAL2 LANE0>, <OFFSET1_VAL4 LANE0>, <OFFSET1_VAL21 LANE0>, <OFFSET1_VAL9 LANE0>, <OFFSET1_VAL13 LANE0>, <OFFSET1_VAL25 LANE0>,
					<OFFSET1_VAL2 LANE0>, <OFFSET1_VAL4 LANE0>, <OFFSET1_VAL21 LANE0>, <OFFSET1_VAL9 LANE0>, <OFFSET1_VAL13 LANE0>, <OFFSET1_VAL25 LANE0>,
					<OFFSET1_VAL2 LANE0>, <OFFSET1_VAL4 LANE0>, <OFFSET1_VAL21 LANE0>, <OFFSET1_VAL9 LANE0>, <OFFSET1_VAL13 LANE0>, <OFFSET1_VAL25 LANE0>,
					<OFFSET1_VAL2 LANE0>, <OFFSET1_VAL4 LANE0>, <OFFSET1_VAL21 LANE0>, <OFFSET1_VAL9 LANE0>, <OFFSET1_VAL13 LANE0>, <OFFSET1_VAL25 LANE0>;
				cdc-vdd-1p8-supply = <&L15B>;
				qcom,cdc-vdd-1p8-voltage = <1800000 1800000>;
				qcom,cdc-vdd-1p8-current = <20000>;
				qcom,cdc-vdd-1p8-lpm-supported = <1>;
				qcom,cdc-static-supplies = "cdc-vdd-1p8";
				sound-name-prefix = "SpkrRight";
			};

	};


			wsa884x_2_0220: wsa884x@02170220 {
				status = "disabled";
				compatible = "qcom,wsa884x_2";
				reg = <0x4 0x2170220>;
				qcom,spkr-sd-n-node = <&wsa_spkr_en02>;
				qcom,lpass-cdc-handle = <&lpass_cdc>;
				qcom,wsa-macro-handle = <&wsa2_macro>;
				qcom,swr-wsa-port-params =
					<OFFSET1_VAL1 LANE0>, <OFFSET1_VAL3 LANE0>, <OFFSET1_VAL5 LANE0>, <OFFSET1_VAL0 LANE0>, <OFFSET1_VAL6 LANE0>, <OFFSET1_VAL0 LANE0>,
					<OFFSET1_VAL1 LANE0>, <OFFSET1_VAL3 LANE0>, <OFFSET1_VAL5 LANE0>, <OFFSET1_VAL0 LANE0>, <OFFSET1_VAL6 LANE0>, <OFFSET1_VAL0 LANE0>,
					<OFFSET1_VAL1 LANE0>, <OFFSET1_VAL3 LANE0>, <OFFSET1_VAL5 LANE0>, <OFFSET1_VAL0 LANE0>, <OFFSET1_VAL6 LANE0>, <OFFSET1_VAL0 LANE0>,
					<OFFSET1_VAL1 LANE0>, <OFFSET1_VAL3 LANE0>, <OFFSET1_VAL5 LANE0>, <OFFSET1_VAL0 LANE0>, <OFFSET1_VAL6 LANE0>, <OFFSET1_VAL0 LANE0>;
				cdc-vdd-1p8-supply = <&L15B>;
				qcom,cdc-vdd-1p8-voltage = <1800000 1800000>;
				qcom,cdc-vdd-1p8-current = <20000>;
				qcom,cdc-vdd-1p8-lpm-supported = <1>;
				qcom,cdc-static-supplies = "cdc-vdd-1p8";
				sound-name-prefix = "Spkr2Left";
			};

			wsa884x_2_0221: wsa884x@02170221 {
				status = "disabled";
				compatible = "qcom,wsa884x_2";
				reg = <0x4 0x2170221>;
				qcom,spkr-sd-n-node = <&wsa_spkr_en13>;
				qcom,lpass-cdc-handle = <&lpass_cdc>;
				qcom,wsa-macro-handle = <&wsa2_macro>;
				qcom,swr-wsa-port-params =
					<OFFSET1_VAL2 LANE0>, <OFFSET1_VAL4 LANE0>, <OFFSET1_VAL21 LANE0>, <OFFSET1_VAL9 LANE0>, <OFFSET1_VAL13 LANE0>, <OFFSET1_VAL25 LANE0>,
					<OFFSET1_VAL2 LANE0>, <OFFSET1_VAL4 LANE0>, <OFFSET1_VAL21 LANE0>, <OFFSET1_VAL9 LANE0>, <OFFSET1_VAL13 LANE0>, <OFFSET1_VAL25 LANE0>,
					<OFFSET1_VAL2 LANE0>, <OFFSET1_VAL4 LANE0>, <OFFSET1_VAL21 LANE0>, <OFFSET1_VAL9 LANE0>, <OFFSET1_VAL13 LANE0>, <OFFSET1_VAL25 LANE0>,
					<OFFSET1_VAL2 LANE0>, <OFFSET1_VAL4 LANE0>, <OFFSET1_VAL21 LANE0>, <OFFSET1_VAL9 LANE0>, <OFFSET1_VAL13 LANE0>, <OFFSET1_VAL25 LANE0>;
				cdc-vdd-1p8-supply = <&L15B>;
				qcom,cdc-vdd-1p8-voltage = <1800000 1800000>;
				qcom,cdc-vdd-1p8-current = <20000>;
				qcom,cdc-vdd-1p8-lpm-supported = <1>;
				qcom,cdc-static-supplies = "cdc-vdd-1p8";
				sound-name-prefix = "Spkr2Right";
			};

			swr_haptics: swr_haptics@f0170220 {
				compatible = "qcom,pmih010x-swr-haptics";
				reg = <0x03 0xf0170220>;
				swr-slave-supply = <&hap_swr_slave_reg>;
				qcom,rx_swr_ch_map = <0 0x01 0x01 0 OCPM>;
				qcom,rx_swr_vi_ch_map = <2 0x02 0x03 1200000 SPKR_L_VI>;
			};

	};

	wcd939x_codec: wcd939x-codec {
		compatible = "qcom,wcd939x-codec";
		qcom,split-codec = <1>;
		qcom,rx_swr_ch_map = <0 HPH_L 0x1 0 HPH_L>,
			<0 HPH_R 0x2 0 HPH_R>, <1 CLSH 0x1 0 CLSH>,
			<2 COMP_L 0x1 0 COMP_L>, <2 COMP_R 0x2 0 COMP_R>,
			<3 LO 0x1 0 LO>, <4 DSD_L 0x1 0 DSD_L>,
			<4 DSD_R 0x2 0 DSD_R>, <5 HIFI_PCM_L 0x1 0 HIFI_PCM_L>,
			<5 HIFI_PCM_R 0x2 0 HIFI_PCM_R>;

		qcom,tx_swr_ch_map = <0 ADC1 0x1 0 SWRM_TX1_CH1>,
			<0 ADC2 0x2 0 SWRM_TX1_CH2>,
			<1 ADC3 0x1 0 SWRM_TX1_CH3>,
			<1 ADC4 0x2 0 SWRM_TX1_CH4>,
			<2 DMIC0 0x1 0 SWRM_TX2_CH1>,
			<2 DMIC1 0x2 0 SWRM_TX2_CH2>,
			<2 MBHC 0x4 0 SWRM_TX2_CH3>,
			<2 DMIC2 0x4 0 SWRM_TX2_CH3>,
			<2 DMIC3 0x8 0 SWRM_TX2_CH4>,
			<3 DMIC4 0x1 0 SWRM_TX3_CH1>,
			<3 DMIC5 0x2 0 SWRM_TX3_CH2>,
			<3 DMIC6 0x4 0 SWRM_TX3_CH3>,
			<3 DMIC7 0x8 0 SWRM_TX3_CH4>;

		qcom,swr-tx-port-params =
			<OFFSET1_VAL0 LANE1>, <OFFSET1_VAL0 LANE2>, <OFFSET1_VAL1 LANE0>, <OFFSET1_VAL1 LANE0>,
			<OFFSET1_VAL0 LANE1>, <OFFSET1_VAL1 LANE0>, <OFFSET1_VAL1 LANE0>, <OFFSET1_VAL1 LANE0>,
			<OFFSET1_VAL0 LANE1>, <OFFSET1_VAL2 LANE0>, <OFFSET1_VAL1 LANE0>, <OFFSET1_VAL2 LANE0>,
			<OFFSET1_VAL1 LANE0>, <OFFSET1_VAL1 LANE0>, <OFFSET1_VAL1 LANE0>, <OFFSET1_VAL1 LANE0>;

		qcom,wcd-rst-gpio-node = <&wcd939x_rst_gpio>;
		qcom,rx-slave = <&wcd939x_rx_slave>;
		qcom,tx-slave = <&wcd939x_tx_slave>;

		cdc-vdd-rx-supply = <&L15B>;
		qcom,cdc-vdd-rx-voltage = <1800000 1800000>;
		qcom,cdc-vdd-rx-current = <30000>;
		qcom,cdc-vdd-rx-lpm-supported = <1>;

		cdc-vdd-tx-supply = <&L15B>;
		qcom,cdc-vdd-tx-voltage = <1800000 1800000>;
		qcom,cdc-vdd-tx-current = <30000>;
		qcom,cdc-vdd-tx-lpm-supported = <1>;

		cdc-vdd-buck-supply = <&L15B>;
		qcom,cdc-vdd-buck-voltage = <1800000 1800000>;
		qcom,cdc-vdd-buck-current = <650000>;
		qcom,cdc-vdd-buck-lpm-supported = <1>;

		cdc-vdd-mic-bias-supply = <&BOB1>;
		qcom,cdc-vdd-mic-bias-voltage = <3296000 3296000>;
		qcom,cdc-vdd-mic-bias-current = <30000>;

		cdc-vdd-px-supply = <&L1G>;
		qcom,cdc-vdd-px-voltage = <1200000 1200000>;
		qcom,cdc-vdd-px-current = <15000>;
		qcom,cdc-vdd-px-lpm-supported = <1>;

		qcom,cdc-vdd-px-rem-supported = <1>;

		qcom,cdc-micbias1-mv = <1800>;
		qcom,cdc-micbias2-mv = <1800>;
		qcom,cdc-micbias3-mv = <1800>;
		qcom,cdc-micbias4-mv = <1800>;

		qcom,cdc-static-supplies = "cdc-vdd-rx",
					   "cdc-vdd-tx",
					   "cdc-vdd-mic-bias";
		qcom,cdc-on-demand-supplies = "cdc-vdd-buck",
					      "cdc-vdd-px";

		wcd_mb1_reg: qcom,wcd-mb1-reg {
			regulator-name = "wcd-mb1-reg";
		};

		wcd_mb2_reg: qcom,wcd-mb2-reg {
			regulator-name = "wcd-mb2-reg";
		};

		wcd_mb3_reg: qcom,wcd-mb3-reg {
			regulator-name = "wcd-mb3-reg";
		};

		wcd_mb4_reg: qcom,wcd-mb4-reg {
			regulator-name = "wcd-mb4-reg";
		};
	};

};

&lpass_bt_swr {
	clock-names = "bt_swr_mclk_clk", "bt_swr_mclk_clk_2x",
			"lpass_core_hw_vote", "lpass_audio_hw_vote";
	clocks = <&clock_audio_bt_swr_mclk_clk 0>, <&clock_audio_bt_swr_mclk_clk_2x 0>,
			<&lpass_core_hw_vote 0>, <&lpass_audio_hw_vote 0>;
	qcom,bt-swr-gpios = <&bt_swr_gpios>;

	swr4: bt_swr_mstr {
		compatible = "qcom,swr-mstr";
		qcom,swr_master_id = <5>;
		clock-names = "lpass_core_hw_vote",
				"lpass_audio_hw_vote";
		clocks = <&lpass_core_hw_vote 0>,
				<&lpass_audio_hw_vote 0>;
		swrm-io-base = <0x06CA0000 0x0>;
		interrupts = <GIC_SPI 138 IRQ_TYPE_LEVEL_HIGH>;
		interrupt-names = "swr_master_irq";
		qcom,swr-num-ports = <7>;
		qcom,swr-port-mapping = <1 BT_AUDIO_RX1 0x3>,
			<2 BT_AUDIO_RX2 0x3>, <3 BT_AUDIO_RX3 0x3>,
			<5 BT_AUDIO_TX1 0x3>, <6 BT_AUDIO_TX2 0x3>,
			<7 BT_AUDIO_TX3 0x3>, <8 FM_AUDIO_TX1 0x3>;
		qcom,swr-num-dev = <1>;
	};
};

&spf_core_platform  {
	canoe_snd: sound {
		qcom,model = "canoe-mtp-wsa884x-snd-card";
		qcom,msm-mi2s-master = <1>, <1>, <1>, <1>, <1>, <1>, <1>;
		qcom,mi2s-tdm-is-hw-vote-needed = <1>, <1>, <1>, <1>, <1>, <1>, <1>;
		qcom,wcn-bt = <1>;
		qcom,ext-disp-audio-rx = <1>;
		qcom,tdm-max-slots = <8>;
		qcom,tdm-clk-attribute = <0x1>, <0x1>, <0x1>, <0x1>, <0x1>, <0x1>, <0x1>;
		qcom,mi2s-clk-attribute = <0x1>, <0x1>, <0x1>, <0x1>, <0x1>, <0x1>, <0x1>;
		qcom,audio-core-list = <0>, <1>;
		/*
		 * Add this property,
		 * To Enable swr haptics through OPCM port.
		 * This will include wsa2 dailinks.
		 */
		qcom,dedicated-wsa2;
		qcom,audio-routing =
			"AMIC1", "Analog Mic1",
			"AMIC1", "MIC BIAS1",
			"AMIC2", "Analog Mic2",
			"AMIC2", "MIC BIAS2",
			"AMIC3", "Analog Mic3",
			"AMIC3", "MIC BIAS3",
			"AMIC4", "Analog Mic4",
			"AMIC4", "MIC BIAS3",
			"AMIC5", "Analog Mic5",
			"AMIC5", "MIC BIAS4",
			"VA AMIC1", "Analog Mic1",
			"VA AMIC1", "VA MIC BIAS1",
			"VA AMIC2", "Analog Mic2",
			"VA AMIC2", "VA MIC BIAS2",
			"VA AMIC3", "Analog Mic3",
			"VA AMIC3", "VA MIC BIAS3",
			"VA AMIC4", "Analog Mic4",
			"VA AMIC4", "VA MIC BIAS3",
			"VA AMIC5", "Analog Mic5",
			"VA AMIC5", "VA MIC BIAS4",
			"TX DMIC0", "Digital Mic0",
			"TX DMIC0", "MIC BIAS1",
			"TX DMIC1", "Digital Mic1",
			"TX DMIC1", "MIC BIAS1",
			"TX DMIC2", "Digital Mic2",
			"TX DMIC2", "MIC BIAS3",
			"TX DMIC3", "Digital Mic3",
			"TX DMIC3", "MIC BIAS3",
			"IN1_HPHL", "HPHL_OUT",
			"IN2_HPHR", "HPHR_OUT",
			"IN3_EAR", "AUX_OUT",
			"HAP_IN", "WSA2_HAPT OUT",
			"WSA SRC0_INP", "SRC0",
			"WSA_TX DEC0_INP", "TX DEC0 MUX",
			"WSA_TX DEC1_INP", "TX DEC1 MUX",
			"RX_TX DEC0_INP", "TX DEC0 MUX",
			"RX_TX DEC1_INP", "TX DEC1 MUX",
			"RX_TX DEC2_INP", "TX DEC2 MUX",
			"RX_TX DEC3_INP", "TX DEC3 MUX",
			"SpkrLeft IN", "WSA_SPK1 OUT",
			"SpkrRight IN", "WSA_SPK2 OUT",
			"TX SWR_INPUT", "WCD_TX_OUTPUT",
			"VA SWR_INPUT", "VA_SWR_CLK",
			"VA SWR_INPUT", "WCD_TX_OUTPUT",
			"VA_AIF1 CAP", "VA_SWR_CLK",
			"VA_AIF2 CAP", "VA_SWR_CLK",
			"VA_AIF3 CAP", "VA_SWR_CLK",
			"VA DMIC0", "Digital Mic0",
			"VA DMIC1", "Digital Mic1",
			"VA DMIC2", "Digital Mic2",
			"VA DMIC3", "Digital Mic3",
			"VA DMIC0", "VA MIC BIAS1",
			"VA DMIC1", "VA MIC BIAS1",
			"VA DMIC2", "VA MIC BIAS3",
			"VA DMIC3", "VA MIC BIAS3";
		qcom,msm-mbhc-hs-mic-max-threshold-mv = <1670>;
		qcom,msm-mbhc-usbc-audio-supported = <1>;
		qcom,msm-mbhc-hphl-swh = <0>;
		qcom,msm-mbhc-gnd-swh = <0>;
		wcd939x-i2c-handle = <&wcd_usbss>;

		qcom,cdc-dmic01-gpios = <&cdc_dmic01_gpios>;
		qcom,cdc-dmic23-gpios = <&cdc_dmic23_gpios>;
		qcom,cdc-dmic45-gpios = <&cdc_dmic45_gpios>;
		asoc-codec  = <&stub_codec>, <&lpass_cdc>,
			      <&wcd939x_codec>, <&swr_haptics>,
			      <&wsa884x_0220>, <&wsa884x_0221>;
		asoc-codec-names = "msm-stub-codec.1", "lpass-cdc",
				   "wcd939x_codec", "swr-haptics",
			   	"wsa-codec1", "wsa-codec2";
		qcom,wsa-max-devs = <2>;
		qcom,msm_audio_ssr_devs = <&audio_gpr>, <&lpi_tlmm>,
				  <&lpass_cdc>, <&lpass_bt_swr>;

		/*
		 * ====================
		 * UPD backend - WSA
		 * ====================
		 *
		 * Mute/Unmute the interpolator
		 * ------------------------------
		 * Register: LPASS_WSA_CDC_RX0_RX_PATH_MIX_CTL - 0x6B00418
		 *
		 * Send control commands to the peripheral from the soundwire controller
		 * -----------------------------------------------------------------------
		 * Register: LPASS_WSA_SWR_MSTR_WSA_SWRM_CPUn_CMD_FIFO_WR_CMD - 0x6B14020
		 *
		 * Enable/Disable ear piece
		 * --------------------------
		 * Register: DIG_CTRL0_PA_FSM_EN - 0x3430
		 *
		 */
		qcom,upd_backends_used = "wsa";
		qcom,upd_lpass_reg_addr = <0x6B00418 0x6B14020>;
		qcom,upd_ear_pa_reg_addr = <0x3430>;

		/*
		 * ====================
		 * UPD backend - WCD
		 * ====================
		 *
		 * Mute/Unmute the interpolator
		 * ------------------------------
		 * Register: LPASS_WCD_CDC_RX0_RX_PATH_MIX_CTL - 0x6AC0418
		 *
		 * Send control commands to the wcd from the soundwire controller
		 * ----------------------------------------------------------------
		 * Register: LPASS_WCD_SWR_MSTR_WSA_SWRM_CPUn_CMD_FIFO_WR_CMD - 0x7634020
		 *
		 * Enable/Disable ear piece
		 * --------------------------
		 * Register: DIG_CTRL0_PA_FSM_EN - 0x300A
		 *
		 */
		/*
		qcom,upd_backends_used = "wcd";
		qcom,upd_lpass_reg_addr = <0x6AC0418 0x7634020>;
		qcom,upd_ear_pa_reg_addr = <0x300A>;
		*/
	};

	cdc_pri_mi2s_gpios: pri_mi2s_pinctrl {
		status = "disabled";
		compatible = "qcom,msm-cdc-pinctrl";
		pinctrl-names = "aud_active", "aud_sleep";
		pinctrl-0 = <&i2s0_sck_active &i2s0_ws_active
				&i2s0_sd0_active &i2s0_sd1_active>;
		pinctrl-1 = <&i2s0_sck_sleep &i2s0_ws_sleep
				&i2s0_sd0_sleep &i2s0_sd1_sleep>;
		#gpio-cells = <0>;
	};

	fm_i2s1_gpios: fm_i2s1_pinctrl {
		status = "disabled";
		compatible = "qcom,msm-cdc-pinctrl";
		pinctrl-names = "aud_active", "aud_sleep";
		pinctrl-0 = <&i2s1_sck_active &i2s1_ws_active
				&i2s1_sd0_active>;
		pinctrl-1 = <&i2s1_sck_sleep &i2s1_ws_sleep
				&i2s1_sd0_sleep>;
		#gpio-cells = <0>;
	};

	cdc_tert_mi2s_gpios: tert_mi2s_pinctrl {
		status = "disabled";
		compatible = "qcom,msm-cdc-pinctrl";
		pinctrl-names = "aud_active", "aud_sleep";
		pinctrl-0 = <&lpi_i2s4_clk_active &lpi_i2s4_ws_active
				&lpi_i2s4_data0_active &lpi_i2s4_data1_active>;
		pinctrl-1 = <&lpi_i2s4_clk_sleep &lpi_i2s4_ws_sleep
				&lpi_i2s4_data0_sleep &lpi_i2s4_data1_sleep>;
		qcom,lpi-gpios;
		#gpio-cells = <0>;
	};

	cdc_quat_mi2s_gpios: quat_mi2s_pinctrl {
		status = "disabled";
		compatible = "qcom,msm-cdc-pinctrl";
		pinctrl-names = "aud_active", "aud_sleep";
		pinctrl-0 = <&lpi_i2s0_sck_active &lpi_i2s0_ws_active
				&lpi_i2s0_data0_active &lpi_i2s0_data1_active
				&lpi_i2s0_data2_active &lpi_i2s0_data3_active>;
		pinctrl-1 = <&lpi_i2s0_sck_sleep &lpi_i2s0_ws_sleep
				&lpi_i2s0_data0_sleep &lpi_i2s0_data1_sleep
				&lpi_i2s0_data2_sleep &lpi_i2s0_data3_sleep>;
		qcom,lpi-gpios;
		#gpio-cells = <0>;
	};

	cdc_quin_mi2s_gpios: quin_mi2s_pinctrl {
		status = "disabled";
		compatible = "qcom,msm-cdc-pinctrl";
		pinctrl-names = "aud_active", "aud_sleep";
		pinctrl-0 = <&lpi_i2s1_clk_active &lpi_i2s1_ws_active
				&lpi_i2s1_data0_active &lpi_i2s1_data1_active>;
		pinctrl-1 = <&lpi_i2s1_clk_sleep &lpi_i2s1_ws_sleep
				&lpi_i2s1_data0_sleep &lpi_i2s1_data1_sleep>;
		qcom,lpi-gpios;
		#gpio-cells = <0>;
	};

	cdc_sen_mi2s_gpios: sen_mi2s_pinctrl {
		status = "disabled";
		compatible = "qcom,msm-cdc-pinctrl";
		pinctrl-names = "aud_active", "aud_sleep";
		pinctrl-0 = <&lpi_i2s2_clk_active &lpi_i2s2_ws_active
				&lpi_i2s2_data0_active &lpi_i2s2_data1_active>;
		pinctrl-1 = <&lpi_i2s2_clk_sleep &lpi_i2s2_ws_sleep
				&lpi_i2s2_data0_sleep &lpi_i2s2_data1_sleep>;
		qcom,lpi-gpios;
		#gpio-cells = <0>;
	};

	cdc_sep_mi2s_gpios: sep_mi2s_pinctrl {
		status = "disabled";
		compatible = "qcom,msm-cdc-pinctrl";
		pinctrl-names = "aud_active", "aud_sleep";
		pinctrl-0 = <&lpi_i2s3_clk_active &lpi_i2s3_ws_active
				&lpi_i2s3_data0_active &lpi_i2s3_data1_active>;
		pinctrl-1 = <&lpi_i2s3_clk_sleep &lpi_i2s3_ws_sleep
				&lpi_i2s3_data0_sleep &lpi_i2s3_data1_sleep>;
		qcom,lpi-gpios;
		#gpio-cells = <0>;
	};

	wsa_swr_gpios: wsa_swr_clk_data_pinctrl {
		compatible = "qcom,msm-cdc-pinctrl";
		pinctrl-names = "aud_active", "aud_sleep";
		pinctrl-0 = <&wsa_swr_clk_active &wsa_swr_data_active>;
		pinctrl-1 = <&wsa_swr_clk_sleep &wsa_swr_data_sleep>;
		qcom,lpi-gpios;
		#gpio-cells = <0>;
	};

	wsa2_swr_gpios: wsa2_swr_clk_data_pinctrl {
		compatible = "qcom,msm-cdc-pinctrl";
		pinctrl-names = "aud_active", "aud_sleep";
		pinctrl-0 = <&wsa2_swr_clk_active &wsa2_swr_data_active>;
		pinctrl-1 = <&wsa2_swr_clk_sleep &wsa2_swr_data_sleep>;
		qcom,lpi-gpios;
		#gpio-cells = <0>;
	};

	rx_swr_gpios: rx_swr_clk_data_pinctrl {
		compatible = "qcom,msm-cdc-pinctrl";
		pinctrl-names = "aud_active", "aud_sleep";
		pinctrl-0 = <&swr_rx_clk_active &swr_rx_data0_active
				&swr_rx_data1_active>;
		pinctrl-1 = <&swr_rx_clk_sleep &swr_rx_data0_sleep
				&swr_rx_data1_sleep>;
		qcom,lpi-gpios;
		#gpio-cells = <0>;
	};

	va_swr_gpios: tx_swr_clk_data_pinctrl {
		compatible = "qcom,msm-cdc-pinctrl";
		pinctrl-names = "aud_active", "aud_sleep";
		pinctrl-0 = <&swr_tx_clk_active &swr_tx_data0_active
			    &swr_tx_data1_active &swr_tx_data2_active>;
		pinctrl-1 = <&swr_tx_clk_sleep &swr_tx_data0_sleep
			    &swr_tx_data1_sleep &swr_tx_data2_sleep>;
		qcom,lpi-gpios;
		qcom,chip-wakeup-reg = <0xf1a4008>;
		qcom,chip-wakeup-maskbit = <7>;
		qcom,chip-wakeup-default-val = <0x1>;
		#gpio-cells = <0>;
	};

	cdc_dmic01_gpios: cdc_dmic01_pinctrl {
		compatible = "qcom,msm-cdc-pinctrl";
		pinctrl-names = "aud_active", "aud_sleep";
		pinctrl-0 = <&lpi_dmic0_clk_active &lpi_dmic0_data_active>;
		pinctrl-1 = <&lpi_dmic0_clk_sleep &lpi_dmic0_data_sleep>;
		qcom,lpi-gpios;
		#gpio-cells = <0>;
	};

	cdc_dmic23_gpios: cdc_dmic23_pinctrl {
		compatible = "qcom,msm-cdc-pinctrl";
		pinctrl-names = "aud_active", "aud_sleep";
		pinctrl-0 = <&lpi_dmic1_clk_active &lpi_dmic1_data_active>;
		pinctrl-1 = <&lpi_dmic1_clk_sleep &lpi_dmic1_data_sleep>;
		qcom,lpi-gpios;
		#gpio-cells = <0>;
	};

	cdc_dmic45_gpios: cdc_dmic45_pinctrl {
		compatible = "qcom,msm-cdc-pinctrl";
		pinctrl-names = "aud_active", "aud_sleep";
		pinctrl-0 = <&lpi_dmic2_clk_active &lpi_dmic2_data_active>;
		pinctrl-1 = <&lpi_dmic2_clk_sleep &lpi_dmic2_data_sleep>;
		qcom,lpi-gpios;
		#gpio-cells = <0>;
	};

	cdc_dmic67_gpios: cdc_dmic67_pinctrl {
		compatible = "qcom,msm-cdc-pinctrl";
		pinctrl-names = "aud_active", "aud_sleep";
		pinctrl-0 = <&lpi_dmic3_clk_active &lpi_dmic3_data_active>;
		pinctrl-1 = <&lpi_dmic3_clk_sleep &lpi_dmic3_data_sleep>;
		qcom,lpi-gpios;
		#gpio-cells = <0>;
	};

	bt_swr_gpios: bt_swr_clk_data_pinctrl {
		compatible = "qcom,msm-cdc-pinctrl";
		pinctrl-names = "aud_active", "aud_sleep";
		pinctrl-0 = <&qca_swr_clk_active &qca_swr_data_active>;
		pinctrl-1 = <&qca_swr_clk_sleep &qca_swr_data_sleep>;
		qcom,lpi-gpios;
		#gpio-cells = <0>;
	};
};

&soc {
	wsa_spkr_en02: wsa_spkr_en1_pinctrl {
		compatible = "qcom,msm-cdc-pinctrl";
		pinctrl-names = "aud_active", "aud_sleep";
		pinctrl-0 = <&spkr_02_sd_n_active>;
		pinctrl-1 = <&spkr_02_sd_n_sleep>;
		qcom,lpi-gpios;
	};

	wsa_spkr_en13: wsa_spkr_en2_pinctrl {
		compatible = "qcom,msm-cdc-pinctrl";
		pinctrl-names = "aud_active", "aud_sleep";
		pinctrl-0 = <&spkr_13_sd_n_active>;
		pinctrl-1 = <&spkr_13_sd_n_sleep>;
		qcom,lpi-gpios;
	};

	wcd939x_rst_gpio: msm_cdc_pinctrl@32 {
		compatible = "qcom,msm-cdc-pinctrl";
		pinctrl-names = "aud_active", "aud_sleep";
		pinctrl-0 = <&wcd939x_reset_active>;
		pinctrl-1 = <&wcd939x_reset_sleep>;
	};

	clock_audio_va_1: va_core_clk {
		compatible = "qcom,audio-ref-clk";
		qcom,codec-ext-clk-src = <AUDIO_LPASS_MCLK>;
		qcom,codec-lpass-ext-clk-freq = <19200000>;
		qcom,codec-lpass-clk-id = <0x307>;
		#clock-cells = <1>;
	};

	clock_audio_wsa_1: wsa_core_clk {
		compatible = "qcom,audio-ref-clk";
		qcom,codec-ext-clk-src = <AUDIO_LPASS_MCLK_2>;
		qcom,codec-lpass-ext-clk-freq = <19200000>;
		qcom,codec-lpass-clk-id = <0x309>;
		#clock-cells = <1>;
	};

	clock_audio_wsa_2: wsa2_core_clk {
		compatible = "qcom,audio-ref-clk";
		qcom,codec-ext-clk-src = <AUDIO_LPASS_MCLK_9>;
		qcom,codec-lpass-ext-clk-freq = <19200000>;
		qcom,codec-lpass-clk-id = <0x310>;
		#clock-cells = <1>;
	};

	clock_audio_rx_1: rx_core_clk {
		compatible = "qcom,audio-ref-clk";
		qcom,codec-ext-clk-src = <AUDIO_LPASS_MCLK_4>;
		qcom,codec-lpass-ext-clk-freq = <22579200>;
		qcom,codec-lpass-clk-id = <0x30E>;
		#clock-cells = <1>;
	};

	clock_audio_rx_tx: rx_core_tx_clk {
		compatible = "qcom,audio-ref-clk";
		qcom,codec-ext-clk-src = <AUDIO_LPASS_MCLK_10>;
		qcom,codec-lpass-ext-clk-freq = <19200000>;
		qcom,codec-lpass-clk-id = <0x312>;
		#clock-cells = <1>;
	};

	clock_audio_tx_1: tx_core_clk {
		compatible = "qcom,audio-ref-clk";
		qcom,codec-ext-clk-src = <AUDIO_LPASS_MCLK_6>;
		qcom,codec-lpass-ext-clk-freq = <19200000>;
		qcom,codec-lpass-clk-id = <0x30C>;
		#clock-cells = <1>;
	};

	clock_audio_wsa_tx: wsa_core_tx_clk {
		compatible = "qcom,audio-ref-clk";
		qcom,codec-ext-clk-src = <AUDIO_LPASS_MCLK_11>;
		qcom,codec-lpass-ext-clk-freq = <19200000>;
		qcom,codec-lpass-clk-id = <0x314>;
		#clock-cells = <1>;
	};

	clock_audio_wsa2_tx: wsa2_core_tx_clk {
		compatible = "qcom,audio-ref-clk";
		qcom,codec-ext-clk-src = <AUDIO_LPASS_MCLK_12>;
		qcom,codec-lpass-ext-clk-freq = <19200000>;
		qcom,codec-lpass-clk-id = <0x316>;
		#clock-cells = <1>;
	};

	clock_audio_rx_mclk2_2x_clk: rx_mclk2_2x_clk {
		compatible = "qcom,audio-ref-clk";
		qcom,codec-ext-clk-src = <AUDIO_LPASS_MCLK_13>;
		qcom,codec-lpass-ext-clk-freq = <19200000>;
		qcom,codec-lpass-clk-id = <0x318>;
		#clock-cells = <1>;
	};

	clock_audio_bt_swr_mclk_clk: bt_swr_mclk_clk {
		compatible = "qcom,audio-ref-clk";
		qcom,codec-ext-clk-src = <AUDIO_LPASS_MCLK_15>;
		qcom,codec-lpass-ext-clk-freq = <24576000>;
		qcom,codec-lpass-clk-id = <0x31A>;
		#clock-cells = <1>;
	};

	clock_audio_bt_swr_mclk_clk_2x: bt_swr_mclk_clk_2x {
		compatible = "qcom,audio-ref-clk";
		qcom,codec-ext-clk-src = <AUDIO_LPASS_MCLK_16>;
		qcom,codec-lpass-ext-clk-freq = <24576000>;
		qcom,codec-lpass-clk-id = <0x31B>;
		#clock-cells = <1>;
	};
};

