/*
 * SPDX-License-Identifier: BSD-3-Clause
 * Copyright (c) Qualcomm Technologies, Inc. and/or its subsidiaries.
*/

#include "art-audio-qrd-sku2.dtsi"

&wcd939x_codec {
	cdc-vdd-px-supply = <&L3F>;
};
