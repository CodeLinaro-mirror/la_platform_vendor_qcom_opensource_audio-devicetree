//
/* Copyright (c) Qualcomm Technologies, Inc. and/or its subsidiaries.
 *  SPDX-License-Identifier: BSD-3-Clause-Clear
 */
/dts-v1/;
/plugin/;
#include "alor-audio-mtp-wcd939x.dtsi"
/ {
	model = "Qualcomm Technologies, Inc. Alor MTP + Harmonium + Panderio";
	compatible = "qcom,alor-mtp", "qcom,alor", "qcom,mtp";
	qcom,msm-id = <685 0x10000>;
	qcom,board-id = <0x30008 0>;
};
