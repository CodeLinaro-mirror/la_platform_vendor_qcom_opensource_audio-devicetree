/*
 * Copyright (c) Qualcomm Technologies, Inc. and/or its subsidiaries.
 * SPDX-License-Identifier: BSD-3-Clause-Clear
*/

/dts-v1/;
/plugin/;

#include "pebble-audio-qrd.dtsi"

/ {
	model = "Qualcomm Technologies, Inc. Pebble QRD Pandeiro";
	compatible = "qcom,pebble-qrd", "qcom,pebblep-qrd", "qcom,qrd", "qcom,pebble", "qcom,pebblep";
	qcom,msm-id = <735 0x10000>, <741 0x10000>;
	qcom,board-id = <0x1000b 0x0>, <0x2000b 0x0>, <0x1010b 0x0>;
};
