// SPDX-License-Identifier: BSD-3-Clause
/*
 * Copyright (c) Qualcomm Technologies, Inc. and/or its subsidiaries.
 */

/dts-v1/;
/plugin/;

#include "art-audio-cdp.dtsi"

&wcd939x_codec {
	cdc-vdd-px-supply = <&L3F>;
};

&wsa885x_i2c {
	interrupt-gpios = <&tlmm 98 GPIO_ACTIVE_HIGH>;
	vdd-1p8-supply = <&L2D>;
	vdd-io-supply = <&L4G>;
};

&rx_swr_haptics {
	status = "okay";
	swr-slave-supply = <&hap_swr_slave_reg>;
	qcom,rx_swr_ch_map = <0 0x01 0x01 0 HAPT>;
	qcom,rx_swr_vi_ch_map = <2 0x02 0x03 1200000 SWRM_RX_TX1>;
};

&art_snd {
	qcom,model = "pebble-cdp-snd-card";
	qcom,wcn-bt = <0>;
	qcom,wcn-bt-ext = <0>;
	qcom,ext-disp-audio-rx = <0>;
	asoc-codec  = <&stub_codec>, <&lpass_cdc>,
		      <&rx_swr_haptics>, <&wcd939x_codec>, <&wsa885x_i2c>;
	asoc-codec-names = "msm-stub-codec.1", "lpass-cdc",
			"swr-haptics", "wcd939x_codec", "wsa885x_i2c";

	qcom,audio-routing =
		"AMIC1", "Analog Mic1",
		"AMIC1", "MIC BIAS1",
		"AMIC2", "Analog Mic2",
		"AMIC2", "MIC BIAS2",
		"AMIC3", "Analog Mic3",
		"AMIC3", "MIC BIAS1",
		"AMIC4", "Analog Mic4",
		"AMIC4", "MIC BIAS3",
		"AMIC5", "Analog Mic5",
		"AMIC5", "MIC BIAS4",
		"VA AMIC1", "Analog Mic1",
		"VA AMIC1", "VA MIC BIAS1",
		"VA AMIC2", "Analog Mic2",
		"VA AMIC2", "VA MIC BIAS2",
		"VA AMIC3", "Analog Mic3",
		"VA AMIC3", "VA MIC BIAS1",
		"VA AMIC4", "Analog Mic4",
		"VA AMIC4", "VA MIC BIAS3",
		"VA AMIC5", "Analog Mic5",
		"VA AMIC5", "VA MIC BIAS4",
		"TX DMIC0", "Digital Mic0",
		"TX DMIC0", "MIC BIAS1",
		"TX DMIC1", "Digital Mic1",
		"TX DMIC1", "MIC BIAS1",
		"TX DMIC2", "Digital Mic2",
		"TX DMIC2", "MIC BIAS3",
		"TX DMIC3", "Digital Mic3",
		"TX DMIC3", "MIC BIAS3",
		"TX DMIC4", "Digital Mic4",
		"TX DMIC4", "MIC BIAS4",
		"TX DMIC5", "Digital Mic5",
		"TX DMIC5", "MIC BIAS4",
		"TX DMIC6", "Digital Mic6",
		"TX DMIC6", "MIC BIAS3",
		"TX DMIC7", "Digital Mic7",
		"TX DMIC7", "MIC BIAS4",
		"IN1_HPHL", "HPHL_OUT",
		"IN2_HPHR", "HPHR_OUT",
		"IN3_EAR",  "AUX_OUT",
		"HAP_IN", "PCM_OUT",
		"RX_TX DEC0_INP", "TX DEC0 MUX",
		"RX_TX DEC1_INP", "TX DEC1 MUX",
		"RX_TX DEC2_INP", "TX DEC2 MUX",
		"RX_TX DEC3_INP", "TX DEC3 MUX",
		"TX SWR_INPUT", "WCD_TX_OUTPUT",
		"VA SWR_INPUT", "VA_SWR_CLK",
		"VA SWR_INPUT", "WCD_TX_OUTPUT",
		"VA_AIF1 CAP", "VA_SWR_CLK",
		"VA_AIF2 CAP", "VA_SWR_CLK",
		"VA_AIF3 CAP", "VA_SWR_CLK",
		"VA DMIC0", "Digital Mic0",
		"VA DMIC1", "Digital Mic1",
		"VA DMIC2", "Digital Mic2",
		"VA DMIC3", "Digital Mic3",
		"VA DMIC4", "Digital Mic4",
		"VA DMIC5", "Digital Mic5",
		"VA DMIC6", "Digital Mic6",
		"VA DMIC7", "Digital Mic7",
		"VA DMIC0", "VA MIC BIAS1",
		"VA DMIC1", "VA MIC BIAS1",
		"VA DMIC2", "VA MIC BIAS3",
		"VA DMIC3", "VA MIC BIAS3",
		"VA DMIC4", "VA MIC BIAS4",
		"VA DMIC5", "VA MIC BIAS4",
		"VA DMIC6", "VA MIC BIAS3",
		"VA DMIC7", "VA MIC BIAS4";
};
