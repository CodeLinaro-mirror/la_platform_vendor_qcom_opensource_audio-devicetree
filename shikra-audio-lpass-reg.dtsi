/*
 * Copyright (c) Qualcomm Technologies, Inc. and/or its subsidiaries.
 * SPDX-License-Identifier: BSD-3-Clause
*/

&rx_macro  {
	reg = <0x0A040000 0x0>;
};

&va_macro {
	reg = <0x0A078000 0x0>;
};

/* RX_SWR */
&swr0 {
	swrm-io-base = <0x0A060000 0x0>;
	interrupts = <GIC_SPI 330 IRQ_TYPE_LEVEL_HIGH>;
};

/* VA_SWR
 * vector# is within SPI range (32-992) and Use GIC_SPI
 * To get the interrupt vector# - 32
 */
&swr1 {
	swrm-io-base = <0x0A080000 0x0>;
	interrupts = <GIC_SPI 328 IRQ_TYPE_LEVEL_HIGH>,
				<GIC_SPI 406 IRQ_TYPE_LEVEL_HIGH>;
};
