// SPDX-License-Identifier: BSD-3-Clause
/* 
 * Copyright (c) Qualcomm Technologies, Inc. and/or its subsidiaries.
 */

/dts-v1/;
/plugin/;

#include "chora-audio-mtp-qmp.dtsi"

/ {
	model = "Qualcomm Technologies, Inc. chora MTP + QMP + Pandeiro";
	compatible = "qcom,chora-mtp", "qcom,chora", "qcom,mtp";
	qcom,msm-id = <724 0x10000>;
	qcom,board-id = <0x20008 0>;
};
