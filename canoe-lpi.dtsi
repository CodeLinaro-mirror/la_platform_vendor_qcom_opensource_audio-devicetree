// SPDX-License-Identifier: BSD-3-Clause
/*
 * Copyright (c) 2024 Qualcomm Innovation Center, Inc. All rights reserved.
 */

&lpi_tlmm {
	_active: _active {
		mux {
			pins = "gpio0";
			function = "func0";
		};

		config {
			pins = "gpio0";

		};
	};

	_sleep: _sleep {
		mux {
			pins = "gpio0";
			function = "func0";
		};

		config {
			pins = "gpio0";
		};
	};

	swr_tx_clk_active: swr_tx_clk_active {
		mux {
			pins = "gpio0";
			function = "func1";
			
		};

		config {
			pins = gpio0";
		};
	};

	swr_tx_clk_sleep: swr_tx_clk_sleep {
		mux {
			pins = "gpio0";
			function = "func1";
		};

		config {
			pins = "gpio0";
			
		};
	};

	lpi_i2s0_sck_active: lpi_i2s0_sck_active {
		mux {
			pins = "gpio0";
			function = "func2";
		};

		config {
			pins = "gpio0";
			
		};
	};

	lpi_i2s0_sck_sleep: lpi_i2s0_sck_sleep {
		mux {
			pins = "gpio0";
			function = "func2";
		};

		config {
			pins = "gpio0";
			
		};
	};

	test_bus_0_active: test_bus_0_active {
		mux {
			pins = "gpio0";
			function = "func3";
		};

		config {
			pins = "gpio0";

		};
	};

	test_bus_0_sleep: test_bus_0_sleep {
		mux {
			pins = "gpio0";
			function = "func3";
		};

		config {
			pins = "gpio0";
		};
	};

	_active: _active {
		mux {
			pins = "gpio1";
			function = "func0";
		};

		config {
			pins = "gpio1";

		};
	};

	_sleep: _sleep {
		mux {
			pins = "gpio1";
			function = "func0";
		};

		config {
			pins = "gpio1";
		};
	};

	swr_tx_data0_active: swr_tx_data0_active {
		mux {
			pins = "gpio1";
			function = "func1";
		};

		config {
			pins = "gpio1";
			

		};
	};

	swr_tx_data0_sleep: swr_tx_data0_sleep {
		mux {
			pins = "gpio1";
			function = "func1";
		};

		config {
			pins = "gpio1";
			
		};
	};

	lpi_i2s0_ws_active: lpi_i2s0_ws_active {
		mux {
			pins = "gpio1";
			function = "func2";
		};

		config {
			pins = "gpio1";
			
		};
	};

	lpi_i2s0_ws_sleep: lpi_i2s0_ws_sleep {
		mux {
			pins = "gpio1";
			function = "func2";
		};

		config {
			pins = "gpio1";
			
		};
	};

	test_bus_1_active: test_bus_1_active {
		mux {
			pins = "gpio1";
			function = "func3";
		};

		config {
			pins = "gpio1";

		};
	};

	test_bus_1_sleep: test_bus_1_sleep {
		mux {
			pins = "gpio1";
			function = "func3";
		};

		config {
			pins = "gpio1";
		};
	};

	_active: _active {
		mux {
			pins = "gpio2";
			function = "func0";
		};

		config {
			pins = "gpio2";

		};
	};

	_sleep: _sleep {
		mux {
			pins = "gpio2";
			function = "func0";
		};

		config {
			pins = "gpio2";
		};
	};

	swr_tx_data1_active: swr_tx_data1_active {
		mux {
			pins = "gpio2";
			function = "func1";
		};

		config {
			pins = "gpio2";
			

		};
	};

	swr_tx_data1_sleep: swr_tx_data1_sleep {
		mux {
			pins = "gpio2";
			function = "func1";
		};

		config {
			pins = "gpio2";
			
		};
	};

	lpi_i2s0_data0_active: lpi_i2s0_data0_active {
		mux {
			pins = "gpio2";
			function = "func2";
		};

		config {
			pins = "gpio2";
			
		};
	};

	lpi_i2s0_data0_sleep: lpi_i2s0_data0_sleep {
		mux {
			pins = "gpio2";
			function = "func2";
		};

		config {
			pins = "gpio2";
			
		};
	};

	test_bus_2_active: test_bus_2_active {
		mux {
			pins = "gpio2";
			function = "func3";
		};

		config {
			pins = "gpio2";

		};
	};

	test_bus_2_sleep: test_bus_2_sleep {
		mux {
			pins = "gpio2";
			function = "func3";
		};

		config {
			pins = "gpio2";
		};
	};

	_active: _active {
		mux {
			pins = "gpio3";
			function = "func0";
		};

		config {
			pins = "gpio3";

		};
	};

	_sleep: _sleep {
		mux {
			pins = "gpio3";
			function = "func0";
		};

		config {
			pins = "gpio3";
		};
	};

	swr_rx_clk_active: swr_rx_clk_active {
		mux {
			pins = "gpio3";
			function = "func1";
			
		};

		config {
			pins = gpio3";
		};
	};

	swr_rx_clk_sleep: swr_rx_clk_sleep {
		mux {
			pins = "gpio3";
			function = "func1";
		};

		config {
			pins = "gpio3";
			
		};
	};

	lpi_i2s0_data1_active: lpi_i2s0_data1_active {
		mux {
			pins = "gpio3";
			function = "func2";
		};

		config {
			pins = "gpio3";
			
		};
	};

	lpi_i2s0_data1_sleep: lpi_i2s0_data1_sleep {
		mux {
			pins = "gpio3";
			function = "func2";
		};

		config {
			pins = "gpio3";
			
		};
	};

	test_bus_3_active: test_bus_3_active {
		mux {
			pins = "gpio3";
			function = "func3";
		};

		config {
			pins = "gpio3";

		};
	};

	test_bus_3_sleep: test_bus_3_sleep {
		mux {
			pins = "gpio3";
			function = "func3";
		};

		config {
			pins = "gpio3";
		};
	};

	_active: _active {
		mux {
			pins = "gpio4";
			function = "func0";
		};

		config {
			pins = "gpio4";

		};
	};

	_sleep: _sleep {
		mux {
			pins = "gpio4";
			function = "func0";
		};

		config {
			pins = "gpio4";
		};
	};

	swr_rx_data0_active: swr_rx_data0_active {
		mux {
			pins = "gpio4";
			function = "func1";
		};

		config {
			pins = "gpio4";
			

		};
	};

	swr_rx_data0_sleep: swr_rx_data0_sleep {
		mux {
			pins = "gpio4";
			function = "func1";
		};

		config {
			pins = "gpio4";
			
		};
	};

	lpi_i2s0_data2_active: lpi_i2s0_data2_active {
		mux {
			pins = "gpio4";
			function = "func2";
		};

		config {
			pins = "gpio4";
			
		};
	};

	lpi_i2s0_data2_sleep: lpi_i2s0_data2_sleep {
		mux {
			pins = "gpio4";
			function = "func2";
		};

		config {
			pins = "gpio4";
			
		};
	};

	test_bus_4_active: test_bus_4_active {
		mux {
			pins = "gpio4";
			function = "func3";
		};

		config {
			pins = "gpio4";

		};
	};

	test_bus_4_sleep: test_bus_4_sleep {
		mux {
			pins = "gpio4";
			function = "func3";
		};

		config {
			pins = "gpio4";
		};
	};

	_active: _active {
		mux {
			pins = "gpio5";
			function = "func0";
		};

		config {
			pins = "gpio5";

		};
	};

	_sleep: _sleep {
		mux {
			pins = "gpio5";
			function = "func0";
		};

		config {
			pins = "gpio5";
		};
	};

	swr_rx_data1_active: swr_rx_data1_active {
		mux {
			pins = "gpio5";
			function = "func1";
		};

		config {
			pins = "gpio5";
			

		};
	};

	swr_rx_data1_sleep: swr_rx_data1_sleep {
		mux {
			pins = "gpio5";
			function = "func1";
		};

		config {
			pins = "gpio5";
			
		};
	};

	ext_mclk1_c_active: ext_mclk1_c_active {
		mux {
			pins = "gpio5";
			function = "func2";
		};

		config {
			pins = "gpio5";

		};
	};

	ext_mclk1_c_sleep: ext_mclk1_c_sleep {
		mux {
			pins = "gpio5";
			function = "func2";
		};

		config {
			pins = "gpio5";
		};
	};

	lpi_i2s0_data3_active: lpi_i2s0_data3_active {
		mux {
			pins = "gpio5";
			function = "func3";
		};

		config {
			pins = "gpio5";
			
		};
	};

	lpi_i2s0_data3_sleep: lpi_i2s0_data3_sleep {
		mux {
			pins = "gpio5";
			function = "func3";
		};

		config {
			pins = "gpio5";
			
		};
	};

	test_bus_5_active: test_bus_5_active {
		mux {
			pins = "gpio5";
			function = "func4";
		};

		config {
			pins = "gpio5";

		};
	};

	test_bus_5_sleep: test_bus_5_sleep {
		mux {
			pins = "gpio5";
			function = "func4";
		};

		config {
			pins = "gpio5";
		};
	};

	_active: _active {
		mux {
			pins = "gpio6";
			function = "func0";
		};

		config {
			pins = "gpio6";

		};
	};

	_sleep: _sleep {
		mux {
			pins = "gpio6";
			function = "func0";
		};

		config {
			pins = "gpio6";
		};
	};

	lpi_dmic0_clk_active: lpi_dmic0_clk_active {
		mux {
			pins = "gpio6";
			function = "func1";
		};

		config {
			pins = "gpio6";
			

		};
	};

	lpi_dmic0_clk_sleep: lpi_dmic0_clk_sleep {
		mux {
			pins = "gpio6";
			function = "func1";
		};

		config {
			pins = "gpio6";
			
		};
	};

	lpi_i2s1_clk_active: lpi_i2s1_clk_active {
		mux {
			pins = "gpio6";
			function = "func2";
		};

		config {
			pins = "gpio6";
			
		};
	};

	lpi_i2s1_clk_sleep: lpi_i2s1_clk_sleep {
		mux {
			pins = "gpio6";
			function = "func2";
		};

		config {
			pins = "gpio6";
			
		};
	};

	test_bus_6_active: test_bus_6_active {
		mux {
			pins = "gpio6";
			function = "func3";
		};

		config {
			pins = "gpio6";

		};
	};

	test_bus_6_sleep: test_bus_6_sleep {
		mux {
			pins = "gpio6";
			function = "func3";
		};

		config {
			pins = "gpio6";
		};
	};

	_active: _active {
		mux {
			pins = "gpio7";
			function = "func0";
		};

		config {
			pins = "gpio7";

		};
	};

	_sleep: _sleep {
		mux {
			pins = "gpio7";
			function = "func0";
		};

		config {
			pins = "gpio7";
		};
	};

	lpi_dmic0_data_active: lpi_dmic0_data_active {
		mux {
			pins = "gpio7";
			function = "func1";
		};

		config {
			pins ="gpio7";
			

		};
	};

	lpi_dmic0_data_sleep: lpi_dmic0_data_sleep {
		mux {
			pins = "gpio7";
			function = "func1";
		};

		config {
			pins = "gpio7";
			
		};
	};

	lpi_i2s1_ws_active: lpi_i2s1_ws_active {
		mux {
			pins = "gpio7";
			function = "func2";
		};

		config {
			pins = "gpio7";
			
		};
	};

	lpi_i2s1_ws_sleep: lpi_i2s1_ws_sleep {
		mux {
			pins = "gpio7";
			function = "func2";
		};

		config {
			pins = "gpio7";
			
		};
	};

	test_bus_7_active: test_bus_7_active {
		mux {
			pins = "gpio7";
			function = "func3";
		};

		config {
			pins = "gpio7";

		};
	};

	test_bus_7_sleep: test_bus_7_sleep {
		mux {
			pins = "gpio7";
			function = "func3";
		};

		config {
			pins = "gpio7";
		};
	};

	_active: _active {
		mux {
			pins = "gpio8";
			function = "func0";
		};

		config {
			pins = "gpio8";

		};
	};

	_sleep: _sleep {
		mux {
			pins = "gpio8";
			function = "func0";
		};

		config {
			pins = "gpio8";
		};
	};

	lpi_dmic1_clk_active: lpi_dmic1_clk_active {
		mux {
			pins = "gpio8";
			function = "func1";
		};

		config {
			pins = "gpio8";
			

		};
	};

	lpi_dmic1_clk_sleep: lpi_dmic1_clk_sleep {
		mux {
			pins = "gpio8";
			function = "func1";
		};

		config {
			pins = "gpio8";
			
		};
	};

	lpi_i2s1_data0_active: lpi_i2s1_data0_active {
		mux {
			pins = "gpio8";
			function = "func2";
		};

		config {
			pins = "gpio8";
			
		};
	};

	lpi_i2s1_data0_sleep: lpi_i2s1_data0_sleep {
		mux {
			pins = "gpio8";
			function = "func2";
		};

		config {
			pins = "gpio8";
			
		};
	};

	test_bus_8_active: test_bus_8_active {
		mux {
			pins = "gpio8";
			function = "func3";
		};

		config {
			pins = "gpio8";

		};
	};

	test_bus_8_sleep: test_bus_8_sleep {
		mux {
			pins = "gpio8";
			function = "func3";
		};

		config {
			pins = "gpio8";
		};
	};

	_active: _active {
		mux {
			pins = "gpio9";
			function = "func0";
		};

		config {
			pins = "gpio9";

		};
	};

	_sleep: _sleep {
		mux {
			pins = "gpio9";
			function = "func0";
		};

		config {
			pins = "gpio9";
		};
	};

	lpi_dmic1_data_active: lpi_dmic1_data_active {
		mux {
			pins = "gpio9";
			function = "func1";
		};

		config {
			pins ="gpio9";
			

		};
	};

	lpi_dmic1_data_sleep: lpi_dmic1_data_sleep {
		mux {
			pins = "gpio9";
			function = "func1";
		};

		config {
			pins = "gpio9";
			
		};
	};

	lpi_i2s1_data1_active: lpi_i2s1_data1_active {
		mux {
			pins = "gpio9";
			function = "func2";
		};

		config {
			pins = "gpio9";
			
		};
	};

	lpi_i2s1_data1_sleep: lpi_i2s1_data1_sleep {
		mux {
			pins = "gpio9";
			function = "func2";
		};

		config {
			pins = "gpio9";
			
		};
	};

	ext_mclk1_b_active: ext_mclk1_b_active {
		mux {
			pins = "gpio9";
			function = "func3";
		};

		config {
			pins = "gpio9";

		};
	};

	ext_mclk1_b_sleep: ext_mclk1_b_sleep {
		mux {
			pins = "gpio9";
			function = "func3";
		};

		config {
			pins = "gpio9";
		};
	};

	test_bus_9_active: test_bus_9_active {
		mux {
			pins = "gpio9";
			function = "func4";
		};

		config {
			pins = "gpio9";

		};
	};

	test_bus_9_sleep: test_bus_9_sleep {
		mux {
			pins = "gpio9";
			function = "func4";
		};

		config {
			pins = "gpio9";
		};
	};

	_active: _active {
		mux {
			pins = "gpio10";
			function = "func0";
		};

		config {
			pins = "gpio10";

		};
	};

	_sleep: _sleep {
		mux {
			pins = "gpio10";
			function = "func0";
		};

		config {
			pins = "gpio10";
		};
	};

	lpi_i2s2_clk_active: lpi_i2s2_clk_active {
		mux {
			pins = "gpio10";
			function = "func1";
		};

		config {
			pins = "gpio10";
			
		};
	};

	lpi_i2s2_clk_sleep: lpi_i2s2_clk_sleep {
		mux {
			pins = "gpio10";
			function = "func1";
		};

		config {
			pins = "gpio10";
			
		};
	};

	wsa_swr_clk_active: wsa_swr_clk_active {
		mux {
			pins = "gpio10";
			function = "func2";
			
		};

		config {
			pins = gpio10";
		};
	};

	wsa_swr_clk_sleep: wsa_swr_clk_sleep {
		mux {
			pins = "gpio10";
			function = "func2";
		};

		config {
			pins = "gpio10";
			
		};
	};

	test_bus_10_active: test_bus_10_active {
		mux {
			pins = "gpio10";
			function = "func3";
		};

		config {
			pins = "gpio10";

		};
	};

	test_bus_10_sleep: test_bus_10_sleep {
		mux {
			pins = "gpio10";
			function = "func3";
		};

		config {
			pins = "gpio10";
		};
	};

	_active: _active {
		mux {
			pins = "gpio11";
			function = "func0";
		};

		config {
			pins = "gpio11";

		};
	};

	_sleep: _sleep {
		mux {
			pins = "gpio11";
			function = "func0";
		};

		config {
			pins = "gpio11";
		};
	};

	lpi_i2s2_ws_active: lpi_i2s2_ws_active {
		mux {
			pins = "gpio11";
			function = "func1";
		};

		config {
			pins = "gpio11";
			
		};
	};

	lpi_i2s2_ws_sleep: lpi_i2s2_ws_sleep {
		mux {
			pins = "gpio11";
			function = "func1";
		};

		config {
			pins = "gpio11";
			
		};
	};

	wsa_swr_data_active: wsa_swr_data_active {
		mux {
			pins = "gpio11";
			function = "func2";
		};

		config {
			pins = "gpio11";
			

		};
	};

	wsa_swr_data_sleep: wsa_swr_data_sleep {
		mux {
			pins = "gpio11";
			function = "func2";
		};

		config {
			pins = "gpio11";
			
		};
	};

	test_bus_11_active: test_bus_11_active {
		mux {
			pins = "gpio11";
			function = "func3";
		};

		config {
			pins = "gpio11";

		};
	};

	test_bus_11_sleep: test_bus_11_sleep {
		mux {
			pins = "gpio11";
			function = "func3";
		};

		config {
			pins = "gpio11";
		};
	};

	_active: _active {
		mux {
			pins = "gpio12";
			function = "func0";
		};

		config {
			pins = "gpio12";

		};
	};

	_sleep: _sleep {
		mux {
			pins = "gpio12";
			function = "func0";
		};

		config {
			pins = "gpio12";
		};
	};

	lpi_dmic2_clk_active: lpi_dmic2_clk_active {
		mux {
			pins = "gpio12";
			function = "func1";
		};

		config {
			pins = "gpio12";
			

		};
	};

	lpi_dmic2_clk_sleep: lpi_dmic2_clk_sleep {
		mux {
			pins = "gpio12";
			function = "func1";
		};

		config {
			pins = "gpio12";
			
		};
	};

	lpi_i2s3_clk_active: lpi_i2s3_clk_active {
		mux {
			pins = "gpio12";
			function = "func2";
		};

		config {
			pins = "gpio12";
			
		};
	};

	lpi_i2s3_clk_sleep: lpi_i2s3_clk_sleep {
		mux {
			pins = "gpio12";
			function = "func2";
		};

		config {
			pins = "gpio12";
			
		};
	};

	test_bus_12_active: test_bus_12_active {
		mux {
			pins = "gpio12";
			function = "func3";
		};

		config {
			pins = "gpio12";

		};
	};

	test_bus_12_sleep: test_bus_12_sleep {
		mux {
			pins = "gpio12";
			function = "func3";
		};

		config {
			pins = "gpio12";
		};
	};

	_active: _active {
		mux {
			pins = "gpio13";
			function = "func0";
		};

		config {
			pins = "gpio13";

		};
	};

	_sleep: _sleep {
		mux {
			pins = "gpio13";
			function = "func0";
		};

		config {
			pins = "gpio13";
		};
	};

	lpi_dmic2_data_active: lpi_dmic2_data_active {
		mux {
			pins = "gpio13";
			function = "func1";
		};

		config {
			pins ="gpio13";
			

		};
	};

	lpi_dmic2_data_sleep: lpi_dmic2_data_sleep {
		mux {
			pins = "gpio13";
			function = "func1";
		};

		config {
			pins = "gpio13";
			
		};
	};

	lpi_i2s3_ws_active: lpi_i2s3_ws_active {
		mux {
			pins = "gpio13";
			function = "func2";
		};

		config {
			pins = "gpio13";
			
		};
	};

	lpi_i2s3_ws_sleep: lpi_i2s3_ws_sleep {
		mux {
			pins = "gpio13";
			function = "func2";
		};

		config {
			pins = "gpio13";
			
		};
	};

	ext_mclk1_a_active: ext_mclk1_a_active {
		mux {
			pins = "gpio13";
			function = "func3";
		};

		config {
			pins = "gpio13";

		};
	};

	ext_mclk1_a_sleep: ext_mclk1_a_sleep {
		mux {
			pins = "gpio13";
			function = "func3";
		};

		config {
			pins = "gpio13";
		};
	};

	test_bus_13_active: test_bus_13_active {
		mux {
			pins = "gpio13";
			function = "func4";
		};

		config {
			pins = "gpio13";

		};
	};

	test_bus_13_sleep: test_bus_13_sleep {
		mux {
			pins = "gpio13";
			function = "func4";
		};

		config {
			pins = "gpio13";
		};
	};

	lpass_lpi_dbg_clk_active: lpass_lpi_dbg_clk_active {
		mux {
			pins = "gpio13";
			function = "func5";
		};

		config {
			pins = "gpio13";

		};
	};

	lpass_lpi_dbg_clk_sleep: lpass_lpi_dbg_clk_sleep {
		mux {
			pins = "gpio13";
			function = "func5";
		};

		config {
			pins = "gpio13";
		};
	};

	_active: _active {
		mux {
			pins = "gpio14";
			function = "func0";
		};

		config {
			pins = "gpio14";

		};
	};

	_sleep: _sleep {
		mux {
			pins = "gpio14";
			function = "func0";
		};

		config {
			pins = "gpio14";
		};
	};

	swr_tx_data2_active: swr_tx_data2_active {
		mux {
			pins = "gpio14";
			function = "func1";
		};

		config {
			pins = "gpio14";
			

		};
	};

	swr_tx_data2_sleep: swr_tx_data2_sleep {
		mux {
			pins = "gpio14";
			function = "func1";
		};

		config {
			pins = "gpio14";
			
		};
	};

	ext_mclk1_d_active: ext_mclk1_d_active {
		mux {
			pins = "gpio14";
			function = "func2";
		};

		config {
			pins = "gpio14";

		};
	};

	ext_mclk1_d_sleep: ext_mclk1_d_sleep {
		mux {
			pins = "gpio14";
			function = "func2";
		};

		config {
			pins = "gpio14";
		};
	};

	test_bus_14_active: test_bus_14_active {
		mux {
			pins = "gpio14";
			function = "func3";
		};

		config {
			pins = "gpio14";

		};
	};

	test_bus_14_sleep: test_bus_14_sleep {
		mux {
			pins = "gpio14";
			function = "func3";
		};

		config {
			pins = "gpio14";
		};
	};

	_active: _active {
		mux {
			pins = "gpio15";
			function = "func0";
		};

		config {
			pins = "gpio15";

		};
	};

	_sleep: _sleep {
		mux {
			pins = "gpio15";
			function = "func0";
		};

		config {
			pins = "gpio15";
		};
	};

	lpi_i2s2_data0_active: lpi_i2s2_data0_active {
		mux {
			pins = "gpio15";
			function = "func1";
		};

		config {
			pins = "gpio15";
			
		};
	};

	lpi_i2s2_data0_sleep: lpi_i2s2_data0_sleep {
		mux {
			pins = "gpio15";
			function = "func1";
		};

		config {
			pins = "gpio15";
			
		};
	};

	wsa2_swr_clk_active: wsa2_swr_clk_active {
		mux {
			pins = "gpio15";
			function = "func2";
			
		};

		config {
			pins = gpio15";
		};
	};

	wsa2_swr_clk_sleep: wsa2_swr_clk_sleep {
		mux {
			pins = "gpio15";
			function = "func2";
		};

		config {
			pins = "gpio15";
			
		};
	};

	test_bus_15_active: test_bus_15_active {
		mux {
			pins = "gpio15";
			function = "func3";
		};

		config {
			pins = "gpio15";

		};
	};

	test_bus_15_sleep: test_bus_15_sleep {
		mux {
			pins = "gpio15";
			function = "func3";
		};

		config {
			pins = "gpio15";
		};
	};

	_active: _active {
		mux {
			pins = "gpio16";
			function = "func0";
		};

		config {
			pins = "gpio16";

		};
	};

	_sleep: _sleep {
		mux {
			pins = "gpio16";
			function = "func0";
		};

		config {
			pins = "gpio16";
		};
	};

	lpi_i2s2_data1_active: lpi_i2s2_data1_active {
		mux {
			pins = "gpio16";
			function = "func1";
		};

		config {
			pins = "gpio16";
			
		};
	};

	lpi_i2s2_data1_sleep: lpi_i2s2_data1_sleep {
		mux {
			pins = "gpio16";
			function = "func1";
		};

		config {
			pins = "gpio16";
			
		};
	};

	wsa2_swr_data_active: wsa2_swr_data_active {
		mux {
			pins = "gpio16";
			function = "func2";
		};

		config {
			pins = "gpio16";
			

		};
	};

	wsa2_swr_data_sleep: wsa2_swr_data_sleep {
		mux {
			pins = "gpio16";
			function = "func2";
		};

		config {
			pins = "gpio16";
			
		};
	};

	_active: _active {
		mux {
			pins = "gpio17";
			function = "func0";
		};

		config {
			pins = "gpio17";

		};
	};

	_sleep: _sleep {
		mux {
			pins = "gpio17";
			function = "func0";
		};

		config {
			pins = "gpio17";
		};
	};

	lpi_dmic3_clk_active: lpi_dmic3_clk_active {
		mux {
			pins = "gpio17";
			function = "func1";
		};

		config {
			pins = "gpio17";
			

		};
	};

	lpi_dmic3_clk_sleep: lpi_dmic3_clk_sleep {
		mux {
			pins = "gpio17";
			function = "func1";
		};

		config {
			pins = "gpio17";
			
		};
	};

	lpi_i2s3_data0_active: lpi_i2s3_data0_active {
		mux {
			pins = "gpio17";
			function = "func2";
		};

		config {
			pins = "gpio17";
			
		};
	};

	lpi_i2s3_data0_sleep: lpi_i2s3_data0_sleep {
		mux {
			pins = "gpio17";
			function = "func2";
		};

		config {
			pins = "gpio17";
			
		};
	};

	_active: _active {
		mux {
			pins = "gpio18";
			function = "func0";
		};

		config {
			pins = "gpio18";

		};
	};

	_sleep: _sleep {
		mux {
			pins = "gpio18";
			function = "func0";
		};

		config {
			pins = "gpio18";
		};
	};

	lpi_dmic3_data_active: lpi_dmic3_data_active {
		mux {
			pins = "gpio18";
			function = "func1";
		};

		config {
			pins ="gpio18";
			

		};
	};

	lpi_dmic3_data_sleep: lpi_dmic3_data_sleep {
		mux {
			pins = "gpio18";
			function = "func1";
		};

		config {
			pins = "gpio18";
			
		};
	};

	lpi_i2s3_data1_active: lpi_i2s3_data1_active {
		mux {
			pins = "gpio18";
			function = "func2";
		};

		config {
			pins = "gpio18";
			
		};
	};

	lpi_i2s3_data1_sleep: lpi_i2s3_data1_sleep {
		mux {
			pins = "gpio18";
			function = "func2";
		};

		config {
			pins = "gpio18";
			
		};
	};

	_active: _active {
		mux {
			pins = "gpio19";
			function = "func0";
		};

		config {
			pins = "gpio19";

		};
	};

	_sleep: _sleep {
		mux {
			pins = "gpio19";
			function = "func0";
		};

		config {
			pins = "gpio19";
		};
	};

	lpi_i2s4_clk_active: lpi_i2s4_clk_active {
		mux {
			pins = "gpio19";
			function = "func1";
		};

		config {
			pins = "gpio19";
			
		};
	};

	lpi_i2s4_clk_sleep: lpi_i2s4_clk_sleep {
		mux {
			pins = "gpio19";
			function = "func1";
		};

		config {
			pins = "gpio19";
			
		};
	};

	slimbus_clk_active: slimbus_clk_active {
		mux {
			pins = "gpio19";
			function = "func2";
		};

		config {
			pins = "gpio19";

		};
	};

	slimbus_clk_sleep: slimbus_clk_sleep {
		mux {
			pins = "gpio19";
			function = "func2";
		};

		config {
			pins = "gpio19";
		};
	};

	qca_swr_clk_active: qca_swr_clk_active {
		mux {
			pins = "gpio19";
			function = "func3";
			
		};

		config {
			pins = gpio19";
		};
	};

	qca_swr_clk_sleep: qca_swr_clk_sleep {
		mux {
			pins = "gpio19";
			function = "func3";
		};

		config {
			pins = "gpio19";
			
		};
	};

	_active: _active {
		mux {
			pins = "gpio20";
			function = "func0";
		};

		config {
			pins = "gpio20";

		};
	};

	_sleep: _sleep {
		mux {
			pins = "gpio20";
			function = "func0";
		};

		config {
			pins = "gpio20";
		};
	};

	lpi_i2s4_ws_active: lpi_i2s4_ws_active {
		mux {
			pins = "gpio20";
			function = "func1";
		};

		config {
			pins = "gpio20";
			
		};
	};

	lpi_i2s4_ws_sleep: lpi_i2s4_ws_sleep {
		mux {
			pins = "gpio20";
			function = "func1";
		};

		config {
			pins = "gpio20";
			
		};
	};

	slimbus_data_active: slimbus_data_active {
		mux {
			pins = "gpio20";
			function = "func2";
		};

		config {
			pins = "gpio20";

		};
	};

	slimbus_data_sleep: slimbus_data_sleep {
		mux {
			pins = "gpio20";
			function = "func2";
		};

		config {
			pins = "gpio20";
		};
	};

	qca_swr_data_active: qca_swr_data_active {
		mux {
			pins = "gpio20";
			function = "func3";
		};

		config {
			pins = "gpio20";
			

		};
	};

	qca_swr_data_sleep: qca_swr_data_sleep {
		mux {
			pins = "gpio20";
			function = "func3";
		};

		config {
			pins = "gpio20";
			
		};
	};

	_active: _active {
		mux {
			pins = "gpio21";
			function = "func0";
		};

		config {
			pins = "gpio21";

		};
	};

	_sleep: _sleep {
		mux {
			pins = "gpio21";
			function = "func0";
		};

		config {
			pins = "gpio21";
		};
	};

	lpi_i2s4_data0_active: lpi_i2s4_data0_active {
		mux {
			pins = "gpio21";
			function = "func1";
		};

		config {
			pins = "gpio21";
			
		};
	};

	lpi_i2s4_data0_sleep: lpi_i2s4_data0_sleep {
		mux {
			pins = "gpio21";
			function = "func1";
		};

		config {
			pins = "gpio21";
			
		};
	};

	_active: _active {
		mux {
			pins = "gpio22";
			function = "func0";
		};

		config {
			pins = "gpio22";

		};
	};

	_sleep: _sleep {
		mux {
			pins = "gpio22";
			function = "func0";
		};

		config {
			pins = "gpio22";
		};
	};

	lpi_i2s4_data1_active: lpi_i2s4_data1_active {
		mux {
			pins = "gpio22";
			function = "func1";
		};

		config {
			pins = "gpio22";
			
		};
	};

	lpi_i2s4_data1_sleep: lpi_i2s4_data1_sleep {
		mux {
			pins = "gpio22";
			function = "func1";
		};

		config {
			pins = "gpio22";
			
		};
	};

	ext_mclk1_e_active: ext_mclk1_e_active {
		mux {
			pins = "gpio22";
			function = "func2";
		};

		config {
			pins = "gpio22";

		};
	};

	ext_mclk1_e_sleep: ext_mclk1_e_sleep {
		mux {
			pins = "gpio22";
			function = "func2";
		};

		config {
			pins = "gpio22";
		};
	};
};