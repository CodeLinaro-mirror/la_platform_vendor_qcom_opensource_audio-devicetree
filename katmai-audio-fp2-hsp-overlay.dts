// SPDX-License-Identifier: BSD-3-Clause
/*
 * Copyright (c) 2025 Qualcomm Innovation Center, Inc. All rights reserved.
 */

/dts-v1/;
/plugin/;

#include "yupik-iot-audio-overlay.dtsi"

/ {
        model = "Qualcomm Technologies, Inc. Katmai FP2 IoT HSP";
        compatible = "qcom,yupik-iot-idp", "qcom,yupik-iot", "qcom,idp";
        qcom,msm-id = <497 0x10000>, <575 0x10000>, <576 0x10000>;
        qcom,board-id = <34 1>;
        qcom,softsku-id = <2>;
};
