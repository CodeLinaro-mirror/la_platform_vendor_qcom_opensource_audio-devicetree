//
/* Copyright (c) Qualcomm Technologies, Inc. and/or its subsidiaries.
 *  SPDX-License-Identifier: BSD-3-Clause
 */

#include "tuna-audio-cdp.dtsi"

&lpass_bt_swr {
	status = "disabled";
};

&tuna_snd {
	qcom,model = "tuna-cdp-snd-card";
	qcom,msm_audio_ssr_devs = <&audio_gpr>, <&lpi_tlmm>,
				<&lpass_cdc>;
};
