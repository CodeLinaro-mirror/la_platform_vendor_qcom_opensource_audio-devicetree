/*
 * Copyright (c) Qualcomm Technologies, Inc. and/or its subsidiaries.
 * SPDX-License-Identifier: BSD-3-Clause-Clear
*/

/dts-v1/;
/plugin/;

#include "pebble-audio-cdp.dtsi"

/ {
	model = "Qualcomm Technologies, Inc. Pebble CDP Pandeiro";
	compatible = "qcom,pebble-cdp", "qcom,pebblep-cdp", "qcom,cdp", "qcom,pebble", "qcom,pebblep";
	qcom,msm-id = <735 0x10000>, <741 0x10000>;
	qcom,board-id = <0x30001 0x0>, <0x40001 0x0>, <0x10001 0x0>,
			<0x20001 0x0>, <0x10101 0x0>, <1 0>;
};
