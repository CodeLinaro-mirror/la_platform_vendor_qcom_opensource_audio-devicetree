// SPDX-License-Identifier: BSD-3-Clause
/*
 * Copyright (c) 2023-2024 Qualcomm Innovation Center, Inc. All rights reserved.
 */

/dts-v1/;
/plugin/;

#include "canoe-audio-cdp-wsa885x.dtsi"
 / {
	model = "Qualcomm Technologies, Inc. Canoe CDP";
	compatible = "qcom,canoe-cdp", "qcom,canoe", "qcom,canoep-cdp", "qcom,canoep",
			   "qcom,cdp";
	qcom,msm-id = <0x10294 0x10000>, <0x10294 0x20000>, <0x10295 0x10000>, <0x10295 0x20000>,
		      <0x1010294 0x10000>, <0x1010294 0x20000>, <0x1010295 0x10000>,
		      <0x1010295 0x20000>;
	qcom,board-id = <0x1000001 0>;
};
