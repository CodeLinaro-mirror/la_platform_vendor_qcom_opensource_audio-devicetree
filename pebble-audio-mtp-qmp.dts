// SPDX-License-Identifier: BSD-3-Clause
/*
 * Copyright (c) Qualcomm Technologies, Inc. and/or its subsidiaries.
 */

/dts-v1/;
/plugin/;

#include "pebble-audio-mtp-qmp.dtsi"
/ {
	model = "Qualcomm Technologies, Inc. Pebble MTP + Rf(P) + pandeiro";
	compatible = "qcom,pebble-mtp", "qcom,pebblep-mtp", "qcom,mtp", "qcom,pebble", "qcom,pebblep";
	qcom,msm-id = <735 0x10000>, <741 0x10000>;
	qcom,board-id = <0x50008 0x0>;
};

