// SPDX-License-Identifier: BSD-3-Clause
/*
 * Copyright (c) Qualcomm Technologies, Inc. and/or its subsidiaries.
 */

/dts-v1/;
/plugin/;

#include "yupik-iot-audio-rb3-gen2-vc.dtsi"

/ {
	model = "Qualcomm Technologies, Inc. YUPIK-IOT RB3 GEN2 videoCollabKit";
	compatible = "qcom,yupik-iot-idp", "qcom,yupik-iot", "qcom,idp";
	qcom,msm-id = <498 0x10000>;
	qcom,board-id = <0x010020 1>;
};
