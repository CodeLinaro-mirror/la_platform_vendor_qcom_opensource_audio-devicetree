// SPDX-License-Identifier: BSD-3-Clause
/*
 * Copyright (c) 2024-2025 Qualcomm Innovation Center, Inc. All rights reserved.
 */

#include "lpass-audio-cdc-1.0.dtsi"
#include "wsa884x.dtsi"
#include "wcd939x.dtsi"

&canoe_snd {
	qcom,model = "canoe-rumi-snd-card";
	compatible = "qcom,canoe-asoc-snd-stub";
	asoc-codec = <&stub_codec>;
	asoc-codec-names = "msm-stub-codec.1";
};

&lpi_tlmm {
	status = "disabled";
};

&lpass_cdc {
	status = "disabled";
};

&lpass_bt_swr {
	status = "disabled";
};
