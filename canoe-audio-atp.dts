// SPDX-License-Identifier: BSD-3-Clause
/*
 * Copyright (c) 2023-2024 Qualcomm Innovation Center, Inc. All rights reserved.
 */

/dts-v1/;
/plugin/;

#include "canoe-audio-atp.dtsi"
 / {
	model = "Qualcomm Technologies, Inc. Canoe ATP";
	compatible = "qcom,canoe-atp", "qcom,canoe", "qcom,canoep-atp", "qcom,canoep",
				"qcom,atp";
	qcom,msm-id = <0x10294 0x10000>, <0x10294 0x20000>, <0x10295 0x10000>, <0x10295 0x20000>,
		      <0x30294 0x10000>, <0x30294 0x20000>, <0x30295 0x10000>, <0x30295 0x20000>,
		      <0x1010294 0x10000>, <0x1010294 0x20000>, <0x1010295 0x10000>,
		      <0x1010295 0x20000>, <0x1030294 0x10000>, <0x1030294 0x20000>,
		      <0x1030295 0x10000>, <0x1030295 0x20000>;
	qcom,board-id = <0x10021 0>;
};
